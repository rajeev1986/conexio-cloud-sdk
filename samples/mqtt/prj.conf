## CMakeLists.txt
```
cmake_minimum_required(VERSION 3.20.0)

find_package(Zephyr REQUIRED HINTS $ENV{ZEPHYR_BASE})
project(conexio_mqtt)

# ── Source files ──────────────────────────────────────────────────────────────
target_sources(app PRIVATE
  src/main.c
  src/aws_certs.c
  # Build cJSON directly — CONFIG_CJSON_LIB=y produces a cmake-ext project that
  # isn't automatically linked. Compiling cJSON.c as part of the app avoids the
  # linking gap entirely.
  ${ZEPHYR_CJSON_MODULE_DIR}/cJSON.c
)

# ── cJSON include path ────────────────────────────────────────────────────────
target_include_directories(app PRIVATE
  ${ZEPHYR_CJSON_MODULE_DIR}
)

# ── Embed TLS certificates as binary includes ─────────────────────────────────
set(CERT_DIR ${CMAKE_CURRENT_SOURCE_DIR}/src/certs)

generate_inc_file_for_target(app
  ${CERT_DIR}/AmazonRootCA1.pem
  ${ZEPHYR_BINARY_DIR}/include/generated/aws_root_ca.pem.inc
)

generate_inc_file_for_target(app
  ${CERT_DIR}/device.crt
  ${ZEPHYR_BINARY_DIR}/include/generated/aws_device_cert.pem.inc
)

generate_inc_file_for_target(app
  ${CERT_DIR}/device.key
  ${ZEPHYR_BINARY_DIR}/include/generated/aws_device_key.pem.inc
)
```

## Kconfig
```
mainmenu "Conexio Console MQTT Sample"

config CONEXIO_DEVICE_ID
	string "AWS IoT Thing Name / Device ID"
	default "my-nrf-device"
	help
	  Must match the Thing name you created in AWS IoT Core.
	  This is also the deviceId sent in every telemetry payload
	  and used in the MQTT topic: devices/<DEVICE_ID>/telemetry

config CONEXIO_AWS_BROKER_HOSTNAME
	string "AWS IoT Core MQTT endpoint"
	default "ENDPOINT.iot.us-east-1.amazonaws.com"
	help
	  Get this from:
	    aws iot describe-endpoint --endpoint-type iot:Data-ATS
	  Example: abc123xyz.iot.us-east-1.amazonaws.com

config CONEXIO_TELEMETRY_INTERVAL_SEC
	int "Telemetry publish interval in seconds"
	default 60
	range 10 3600
	help
	  How often to read sensors and publish telemetry to AWS.
	  60 = once per minute (good for testing).
	  3600 = once per hour (good for battery-powered production).

config CONEXIO_MQTT_KEEPALIVE_SEC
	int "MQTT keepalive interval in seconds"
	default 120
	range 30 1200
	help
	  How often to send a MQTT PINGREQ to keep the connection alive.
	  AWS IoT Core maximum keepalive = 1200s (20 minutes).
	  With Option B (disconnect after publish) this only applies during
	  the brief active window, so higher values are fine for battery life.

source "Kconfig.zephyr"
```

## prj.conf
```kconfig
# =============================================================================
# Conexio Console — MQTT/TLS sample for nRF91xx
# nRF Connect SDK v3.2.1
# =============================================================================

# ── Device identity ───────────────────────────────────────────────────────────
# Must match the AWS IoT Thing name exactly.
# Set your device ID (e.g. IMEI or custom identifier)
CONFIG_CONEXIO_DEVICE_ID="your-device-id"
# Set your AWS IoT Core endpoint: aws iot describe-endpoint --endpoint-type iot:Data-ATS
CONFIG_CONEXIO_AWS_BROKER_HOSTNAME="your-endpoint.iot.REGION.amazonaws.com"

# ── Telemetry / keepalive ─────────────────────────────────────────────────────
# TESTING: 60s interval — fast enough to verify connect→publish→disconnect cycle.
# Change to 1800 for overnight battery test.
# AWS IoT Core maximum keepalive = 1200s (20 min).
# With Option B (disconnect after publish) keepalive only applies during the
# brief ~10s active window, so its value doesn't affect battery life.
CONFIG_CONEXIO_TELEMETRY_INTERVAL_SEC=1800
CONFIG_CONEXIO_MQTT_KEEPALIVE_SEC=1200

# ── LTE / modem ───────────────────────────────────────────────────────────────
CONFIG_NRF_MODEM_LIB=y
CONFIG_LTE_LINK_CONTROL=y
CONFIG_LTE_LC_PSM_MODULE=y
CONFIG_LTE_LC_EDRX_MODULE=y
# LTE_LC_CONNECTION_STATUS_MODULE is default y — provides CELL_UPDATE + LTE_MODE_UPDATE events

# ── Modem info — all categories needed for full SDK metrics ───────────────────
CONFIG_MODEM_INFO=y
CONFIG_MODEM_INFO_ADD_NETWORK=y   # _rssi, _cell_id, _tac, _lte_band, _operator
CONFIG_MODEM_INFO_ADD_DEVICE=y    # _modem_fw, _battery_mv, _modem_temp

# ── hwinfo — required for _reboot_reason metric ───────────────────────────────
CONFIG_HWINFO=y

# ── Networking — offloaded stack (nRF91xx modem handles IP+TLS) ───────────────
CONFIG_NETWORKING=y
CONFIG_NET_NATIVE=n
CONFIG_NET_SOCKETS=y
CONFIG_NET_SOCKETS_OFFLOAD=y

# ── C library ─────────────────────────────────────────────────────────────────
CONFIG_NEWLIB_LIBC=y
# Enable float support in printf/snprintf — required with newlib-nano
# (-specs=nano.specs), otherwise %.1f prints literally as "%.1f".
CONFIG_NEWLIB_LIBC_FLOAT_PRINTF=y

# ── TLS credential management ─────────────────────────────────────────────────
CONFIG_TLS_CREDENTIALS=y
CONFIG_MODEM_KEY_MGMT=y

# ── MQTT ──────────────────────────────────────────────────────────────────────
CONFIG_MQTT_LIB=y
CONFIG_MQTT_LIB_TLS=y
CONFIG_MQTT_CLEAN_SESSION=y

# ── JSON (cJSON) ──────────────────────────────────────────────────────────────
# cJSON is compiled directly from ${ZEPHYR_CJSON_MODULE_DIR}/cJSON.c in
# CMakeLists.txt — no need for CONFIG_CJSON_LIB=y (which uses cmake-ext and
# doesn't link the library into the app automatically with NEWLIB_LIBC).
# CONFIG_CJSON_LIB=y

# ── Date/time (for ISO-8601 timestamps) ───────────────────────────────────────
# CONFIG_POSIX_THREADS provides pthread_attr_t which is required by
# <zephyr/posix/signal.h>, pulled in transitively by date_time_modem.c.
# Without it, NEWLIB_LIBC + DATE_TIME fails to compile with:
#   "unknown type name 'pthread_attr_t'"
CONFIG_POSIX_THREADS=y
CONFIG_DATE_TIME=y
CONFIG_DATE_TIME_NTP=y

# ── NVS flash (for persistent reboot counter) ─────────────────────────────────
CONFIG_NVS=y
CONFIG_FLASH=y
CONFIG_FLASH_PAGE_LAYOUT=y
CONFIG_FLASH_MAP=y
CONFIG_MPU_ALLOW_FLASH_WRITE=y

# ── Stack / heap ──────────────────────────────────────────────────────────────
# Increased heap: cJSON builds telemetry payload with ~20 fields including
# boot-once string metrics (_modem_fw, _operator, _sdk_version, _reboot_reason).
CONFIG_MAIN_STACK_SIZE=8192
CONFIG_HEAP_MEM_POOL_SIZE=65536
CONFIG_NEWLIB_LIBC_MIN_REQUIRED_HEAP_SIZE=32768
CONFIG_SYSTEM_WORKQUEUE_STACK_SIZE=2048

# ── Logging ───────────────────────────────────────────────────────────────────
CONFIG_LOG=y
CONFIG_LOG_DEFAULT_LEVEL=3
CONFIG_LOG_BUFFER_SIZE=4096
CONFIG_UART_CONSOLE=y

# ── Safety ────────────────────────────────────────────────────────────────────
CONFIG_REBOOT=y
CONFIG_RESET_ON_FATAL_ERROR=y
CONFIG_FAULT_DUMP=2
CONFIG_BOOTLOADER_MCUBOOT=y
```

## src/aws_certs.c
```c
/*
 * aws_certs.c — Provisions TLS credentials into the nRF91xx modem.
 *
 * Uses write_if_absent() so credentials are only written on the very first
 * boot (or after a factory reset). Subsequent boots skip the write, which
 * means the modem does NOT need to be taken offline on every boot.
 */

#include <zephyr/kernel.h>
#include <modem/modem_key_mgmt.h>
#include <zephyr/logging/log.h>
#include "aws_certs.h"

LOG_MODULE_REGISTER(aws_certs, LOG_LEVEL_INF);

/* Embedded certificate content — generated by CMake from src/certs/*.pem */
static const unsigned char aws_root_ca[] = {
#include "aws_root_ca.pem.inc"
};

static const unsigned char aws_device_cert[] = {
#include "aws_device_cert.pem.inc"
};

static const unsigned char aws_device_key[] = {
#include "aws_device_key.pem.inc"
};

/* Write a credential only if the slot is empty — avoids unnecessary
 * modem offline/online cycles on every boot. */
static int write_if_absent(int tag, enum modem_key_mgmt_cred_type type,
                            const unsigned char *data, size_t len,
                            const char *label)
{
    bool exists = false;
    modem_key_mgmt_exists(tag, type, &exists);
    if (exists) {
        LOG_INF("%s already in modem (tag %d) — skipping", label, tag);
        return 0;
    }
    int ret = modem_key_mgmt_write(tag, type, data, len);
    if (ret < 0) {
        LOG_ERR("Failed to write %s (tag %d): %d", label, tag, ret);
    } else {
        LOG_INF("%s written (tag %d)", label, tag);
    }
    return ret;
}

int aws_certs_provision(void)
{
    int ret;

    LOG_INF("Provisioning TLS credentials...");

    ret = write_if_absent(AWS_CA_TAG,
                          MODEM_KEY_MGMT_CRED_TYPE_CA_CHAIN,
                          aws_root_ca, sizeof(aws_root_ca) - 1,
                          "Root CA");
    if (ret < 0) return ret;

    ret = write_if_absent(AWS_CERT_TAG,
                          MODEM_KEY_MGMT_CRED_TYPE_PUBLIC_CERT,
                          aws_device_cert, sizeof(aws_device_cert) - 1,
                          "Device cert");
    if (ret < 0) return ret;

    ret = write_if_absent(AWS_KEY_TAG,
                          MODEM_KEY_MGMT_CRED_TYPE_PRIVATE_CERT,
                          aws_device_key, sizeof(aws_device_key) - 1,
                          "Device key");
    if (ret < 0) return ret;

    LOG_INF("TLS credentials ready");
    return 0;
}
```

## src/aws_certs.h
```c
#ifndef AWS_CERTS_H
#define AWS_CERTS_H

/*
 * TLS credential tag definitions.
 * These tags are used to register credentials with the modem's TLS stack
 * and reference them when creating a TLS socket.
 */

/** Tag for the AWS Root CA certificate. */
#define AWS_CA_TAG    1

/** Tag for the device client certificate. */
#define AWS_CERT_TAG  2

/** Tag for the device private key. */
#define AWS_KEY_TAG   3

/**
 * @brief Provision TLS credentials into the modem's security storage.
 *
 * Must be called once at startup, before any network connections are made.
 * The certificate content is embedded at build time from src/certs/*.pem.
 *
 * @return 0 on success, negative errno on failure.
 */
int aws_certs_provision(void);

#endif /* AWS_CERTS_H */
```
