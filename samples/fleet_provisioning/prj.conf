## CMakeLists.txt
```
cmake_minimum_required(VERSION 3.20.0)

find_package(Zephyr REQUIRED HINTS $ENV{ZEPHYR_BASE})
project(fleet_provisioning)

target_sources(app PRIVATE
  src/main.c
  src/provision.c
  src/cert_store.c
)

# ── Embed bootstrap (claim) credentials ───────────────────────────────────────
# Place these three files in src/certs/ before building:
#   AmazonRootCA1.pem   — AWS root CA (same for all regions)
#   claim.crt           — shared bootstrap certificate
#   claim.key           — shared bootstrap private key
set(CERT_DIR ${CMAKE_CURRENT_SOURCE_DIR}/src/certs)

generate_inc_file_for_target(app
  ${CERT_DIR}/AmazonRootCA1.pem
  ${ZEPHYR_BINARY_DIR}/include/generated/aws_root_ca.pem.inc
)
generate_inc_file_for_target(app
  ${CERT_DIR}/claim.crt
  ${ZEPHYR_BINARY_DIR}/include/generated/claim_cert.pem.inc
)
generate_inc_file_for_target(app
  ${CERT_DIR}/claim.key
  ${ZEPHYR_BINARY_DIR}/include/generated/claim_key.pem.inc
)
```

## Kconfig
```
mainmenu "Conexio Stratus AWS Fleet Provisioning"

config STRATUS_AWS_ENDPOINT
	string "Conexio Cloud MQTT broker hostname"
	default "mqtt.cloud.conexiotech.com"
	help
	  Conexio Cloud MQTT endpoint (port 8883, TLS mutual auth).
	  Used for both fleet provisioning and normal telemetry operation.
	  Do not change unless self-hosting on a different AWS account.

config STRATUS_FLEET_TEMPLATE
	string "AWS IoT Fleet Provisioning template name"
	default "ConexioFleetTemplate"
	help
	  AWS IoT Fleet Provisioning template to use.
	  Production:  "ConexioFleetTemplate"
	  Development: "ConexioFleetTemplate-dev"
	  Staging:     "ConexioFleetTemplate-staging"
	  Override in prj.conf for non-production builds.

config STRATUS_TELEMETRY_INTERVAL_SEC
	int "Telemetry publish interval (seconds)"
	default 60
	range 10 3600

config STRATUS_MQTT_KEEPALIVE
	int "MQTT keepalive interval (seconds)"
	default 60
	range 30 600

# ── Modem TLS security tags ───────────────────────────────────────────────────
# Claim creds (10-12): embedded bootstrap — shared across all devices.
# Device creds (100-102): issued by AWS per-device during provisioning.
#   These MUST match CONFIG_CONEXIO_CLOUD_CA_TAG / CERT_TAG / KEY_TAG
#   in the main SDK (src/cert_store.c) so the app sample can find them
#   after flashing over the provisioning sample.

config STRATUS_CLAIM_CA_TAG
	int "TLS tag: Root CA for claim phase"
	default 10

config STRATUS_CLAIM_CERT_TAG
	int "TLS tag: Claim certificate"
	default 11

config STRATUS_CLAIM_KEY_TAG
	int "TLS tag: Claim private key"
	default 12

config STRATUS_DEVICE_CA_TAG
	int "TLS tag: Root CA for device phase"
	default 100

config STRATUS_DEVICE_CERT_TAG
	int "TLS tag: Device certificate (issued by AWS)"
	default 101

config STRATUS_DEVICE_KEY_TAG
	int "TLS tag: Device private key (issued by AWS)"
	default 102

config STRATUS_FORCE_REPROVISION
	bool "Force re-provisioning on next boot (developer escape hatch)"
	default n
	help
	  When enabled, clears all device credentials and the provisioning NVS
	  flag on the next boot, forcing a full re-provisioning cycle.
	  Use this to recover from a mismatched cert/key state.
	  Set to y in prj.conf, flash once, then remove and flash again.
	  NEVER enable in production builds.

source "Kconfig.zephyr"
```

## prj.conf
```kconfig
# =============================================================================
# conexio-stratus-provision — AWS Fleet Provisioning for nRF9151/nRF9160
# NCS v3.2.1
# =============================================================================

# ── AWS endpoint ──────────────────────────────────────────────────────────────
# Conexio Cloud MQTT broker — same endpoint used for telemetry and provisioning.
# mqtt.cloud.conexiotech.com is a CNAME to the underlying AWS IoT Core endpoint.
CONFIG_STRATUS_AWS_ENDPOINT="mqtt.cloud.conexiotech.com"
CONFIG_STRATUS_FLEET_TEMPLATE="ConexioFleetTemplate"

CONFIG_STRATUS_TELEMETRY_INTERVAL_SEC=30
# ── Modem ─────────────────────────────────────────────────────────────────────
CONFIG_NRF_MODEM_LIB=y
CONFIG_LTE_LINK_CONTROL=y
CONFIG_MODEM_INFO=y
# Enable PSM API so lte_lc_psm_req() is available in the normal-operation path.
# PSM parameters (T3412/T3324) are set at runtime via lte_lc_psm_req().
CONFIG_LTE_LC_PSM_MODULE=y

# ── Networking — offloaded stack (nRF91xx modem handles IP+TLS) ───────────────
CONFIG_NETWORKING=y
CONFIG_NET_NATIVE=n
CONFIG_NET_SOCKETS=y
CONFIG_NET_SOCKETS_OFFLOAD=y

# ── MQTT ──────────────────────────────────────────────────────────────────────
CONFIG_MQTT_LIB=y
CONFIG_MQTT_LIB_TLS=y
CONFIG_MQTT_CLEAN_SESSION=y
CONFIG_MQTT_KEEPALIVE=60

# ── TLS credential management ─────────────────────────────────────────────────
CONFIG_MODEM_KEY_MGMT=y
CONFIG_TLS_CREDENTIALS=y

# ── C library ─────────────────────────────────────────────────────────────────
# Do NOT set CONFIG_POSIX_API — on NCS v3.2.1 it pulls in POSIX_NETWORKING
# which selects NRF_MODEM_LIB_NET_IF and NET_CONNECTION_MANAGER. Those two
# conflict with our direct lte_lc_connect_async() usage and cause the modem
# socket create to crash when called outside of conn_mgr context.
# All socket calls already use zsock_ prefixes, which is correct without POSIX_API.
#
# POSIX_DEVICE_IO must be set to pre-populate fdtable[0/1/2] with stdin/stdout/stderr.
# Without it ZVFS_OPEN_MAX defaults to 4 and all entries start free, so the first
# zsock_socket() call returns fd=0 (stdin slot). The MQTT library then calls
# zsock_setsockopt(0, SOL_TLS, ...) which hits the stdinout vtable with no TLS
# ioctl handler → null function pointer dereference → BusFault.
CONFIG_POSIX_DEVICE_IO=y
# ZVFS_OPEN_MAX defaults to 4. With stdin/stdout/stderr taking 0/1/2, only
# 1 socket fd would be available — not enough for DNS + TLS simultaneously.
# Set to 8: fds 0-2 = stdio, fds 3-7 = up to 5 concurrent sockets.
CONFIG_ZVFS_OPEN_MAX=8

# ── Base64 (for AT%KEYGEN DER→PEM conversion on nRF9151) ─────────────────────
CONFIG_BASE64=y

# ── JSON ──────────────────────────────────────────────────────────────────────
CONFIG_CJSON_LIB=y

# ── Date/time (NTP sync for ISO-8601 timestamps) ──────────────────────────────
CONFIG_DATE_TIME=y
CONFIG_DATE_TIME_NTP=y

# ── Settings (persists "provisioned" flag across reboots) ─────────────────────
# Use NVS backend so Settings and the reboot counter share the same NVS
# instance on storage_partition without conflict.
# FCB and NVS cannot safely share the same partition simultaneously.
CONFIG_SETTINGS=y
CONFIG_SETTINGS_NVS=y
CONFIG_FLASH=y
CONFIG_FLASH_PAGE_LAYOUT=y
CONFIG_FLASH_MAP=y
CONFIG_MPU_ALLOW_FLASH_WRITE=y

# ── NVS (reboot counter + Settings NVS backend) ───────────────────────────────
CONFIG_NVS=y

# ── Stack / heap ──────────────────────────────────────────────────────────────
CONFIG_MAIN_STACK_SIZE=16384
# Heap must cover: cJSON CSR request (~1.5KB) + cert response parse (~1.7KB) +
# NVS Settings backend metadata + modem library allocations.
# 16384 was too tight — 65536 matches the working fleet-provisioning sample.
CONFIG_HEAP_MEM_POOL_SIZE=65536
CONFIG_SYSTEM_WORKQUEUE_STACK_SIZE=4096

# Stack debugging
CONFIG_INIT_STACKS=y
CONFIG_STACK_SENTINEL=y
# Print PC/LR/SP in fault dump so we can pinpoint the crash address
CONFIG_EXTRA_EXCEPTION_INFO=y

# ── Logging ───────────────────────────────────────────────────────────────────
CONFIG_LOG=y
CONFIG_LOG_DEFAULT_LEVEL=3
# Use immediate (synchronous) mode so logs flush before a fault kills the system.
# Deferred mode can lose the last log line if a crash happens before the log
# thread processes it.
CONFIG_LOG_MODE_IMMEDIATE=y
CONFIG_LOG_BUFFER_SIZE=8192
CONFIG_UART_CONSOLE=y

# ── Safety ────────────────────────────────────────────────────────────────────
CONFIG_REBOOT=y
# Reset on fatal error — enabled for production field devices.
# Allows the device to recover autonomously from hard faults instead of hanging.
# During debugging, set =n to preserve the fault dump on the console.
CONFIG_RESET_ON_FATAL_ERROR=y
CONFIG_FAULT_DUMP=2
CONFIG_STACK_SENTINEL=y
CONFIG_BOOTLOADER_MCUBOOT=y

# ── Random number generator (for telemetry simulation + message IDs) ─────────
# sys_rand32_get() uses the hardware TRNG via the entropy driver.
# Required by <zephyr/random/random.h> — produces properly uncorrelated values
# across reboots unlike k_uptime_get_32().
CONFIG_ENTROPY_GENERATOR=y
CONFIG_TEST_RANDOM_GENERATOR=n

# ── RECOVERY: force re-provisioning (self-clearing — safe to leave in) ───────
# Set to y to force a clean re-provision on next boot (runs once via NVS flag).
# Set to n for normal production operation.
CONFIG_STRATUS_FORCE_REPROVISION=n

# TF-M minimal profile (required for bootloader partition layout)
CONFIG_TFM_PROFILE_TYPE_MINIMAL=y
```

## prj_staging.conf
```kconfig
# ── Staging environment overlay ──────────────────────────────────────────────
# Apply on top of prj.conf for staging builds:
#   west build -b conexio_stratus_pro/nrf9151/ns --pristine \
#              -- -DEXTRA_CONF_FILE=prj_staging.conf
#
# Connects to the same MQTT endpoint (mqtt.cloud.conexiotech.com) but uses
# the staging fleet provisioning template → devices get the -staging IoT policy
# and auto-register into iot-dashboard-devices-staging (not the prod table).
CONFIG_STRATUS_FLEET_TEMPLATE="ConexioFleetTemplate-staging"
```

## boards/conexio_stratus_pro_nrf9151_ns.overlay
```dts
/*
 * Copyright (c) 2024 Conexio Technologies, Inc
 *
 * SPDX-License-Identifier: Apache-2.0
 */

#include <samples/cellular/nrf91_bootloader_partitions.dtsi>

#include <samples/cellular/nrf91_sram_partitions.dtsi>
```

## src/cert_store.c
```c
/*
 * Copyright (c) 2026 Conexio Technologies, Inc.
 *
 * SPDX-License-Identifier: Apache-2.0
 */

/*
 * cert_store.c — Modem credential management
 * NCS v3.2.1 / nRF9151
 */

#include <zephyr/kernel.h>
#include <modem/modem_key_mgmt.h>
#include <zephyr/logging/log.h>
#include <string.h>

#include "cert_store.h"

LOG_MODULE_REGISTER(cert_store, LOG_LEVEL_INF);

/* Embedded bootstrap credentials — built from src/certs/ by CMakeLists.txt */
static const unsigned char aws_root_ca[] = {
#include "aws_root_ca.pem.inc"
};
static const unsigned char claim_cert[] = {
#include "claim_cert.pem.inc"
};
static const unsigned char claim_key[] = {
#include "claim_key.pem.inc"
};

/* ── Helpers ─────────────────────────────────────────────────────────────── */

/* Write only if the slot is empty. */
static int write_if_absent(int tag, enum modem_key_mgmt_cred_type type,
                            const unsigned char *data, size_t len,
                            const char *label)
{
    bool exists = false;

    modem_key_mgmt_exists(tag, type, &exists);
    if (exists) {
        LOG_INF("%s already in modem (tag %d) — skipping", label, tag);
        return 0;
    }
    int ret = modem_key_mgmt_write(tag, type, data, len);
    if (ret) {
        LOG_ERR("Failed to write %s (tag %d): %d", label, tag, ret);
    } else {
        LOG_INF("%s written (tag %d)", label, tag);
    }
    return ret;
}

/* Delete if present — ignores "not found". */
static void delete_if_exists(int tag, enum modem_key_mgmt_cred_type type,
                              const char *label)
{
    bool exists = false;

    modem_key_mgmt_exists(tag, type, &exists);
    if (!exists) {
        return;
    }
    int ret = modem_key_mgmt_delete(tag, type);
    if (ret) {
        LOG_WRN("Delete %s (tag %d) failed: %d — overwrite will be attempted",
                label, tag, ret);
    } else {
        LOG_INF("Deleted %s (tag %d)", label, tag);
    }
}

/* ── Public API ──────────────────────────────────────────────────────────── */

int cert_store_provision_claim_creds(void)
{
    int ret;

    LOG_INF("Provisioning claim credentials...");

    ret = write_if_absent(CONFIG_STRATUS_CLAIM_CA_TAG,
                          MODEM_KEY_MGMT_CRED_TYPE_CA_CHAIN,
                          aws_root_ca, sizeof(aws_root_ca) - 1,
                          "Root CA (claim)");
    if (ret) return ret;

    ret = write_if_absent(CONFIG_STRATUS_DEVICE_CA_TAG,
                          MODEM_KEY_MGMT_CRED_TYPE_CA_CHAIN,
                          aws_root_ca, sizeof(aws_root_ca) - 1,
                          "Root CA (device)");
    if (ret) return ret;

    ret = write_if_absent(CONFIG_STRATUS_CLAIM_CERT_TAG,
                          MODEM_KEY_MGMT_CRED_TYPE_PUBLIC_CERT,
                          claim_cert, sizeof(claim_cert) - 1,
                          "Claim certificate");
    if (ret) return ret;

    ret = write_if_absent(CONFIG_STRATUS_CLAIM_KEY_TAG,
                          MODEM_KEY_MGMT_CRED_TYPE_PRIVATE_CERT,
                          claim_key, sizeof(claim_key) - 1,
                          "Claim private key");
    if (ret) return ret;

    LOG_INF("Claim credentials ready");
    return 0;
}

void cert_store_clear_device_creds(void)
{
    LOG_INF("Clearing stale device credentials...");
    /* Delete only the public certificate at DEVICE_CERT_TAG (101).
     * Do NOT delete the private key at DEVICE_KEY_TAG (102) — it was
     * just generated by AT%KEYGEN in provision_prepare_csr() and must
     * be preserved for the TLS handshake after provisioning completes.
     * AT%KEYGEN already deletes and regenerates the key internally. */
    delete_if_exists(CONFIG_STRATUS_DEVICE_CERT_TAG,
                     MODEM_KEY_MGMT_CRED_TYPE_PUBLIC_CERT, "device cert");
    /* Also delete any stale PRIVATE KEY at DEVICE_CERT_TAG — this was left
     * by old builds that ran AT%KEYGEN=101 (cert tag) instead of 102 (key tag).
     * The modem searches sec_tag_list [100,101,102] for a private key and
     * picks the first match — if tag 101 has an old mismatched key it will
     * be used instead of the correct one at 102, causing TLS auth failure. */
    delete_if_exists(CONFIG_STRATUS_DEVICE_CERT_TAG,
                     MODEM_KEY_MGMT_CRED_TYPE_PRIVATE_CERT, "stale key at cert tag (101)");
    /* Clear old tag 21 slot from pre-migration firmware if still present */
    if (CONFIG_STRATUS_DEVICE_CERT_TAG != 21) {
        delete_if_exists(21, MODEM_KEY_MGMT_CRED_TYPE_PUBLIC_CERT, "device cert (old tag 21)");
    }
}

void cert_store_clean_stale_key_at_cert_tag(void)
{
    /* Delete private key at DEVICE_CERT_TAG (101) if present.
     * This key was left by old firmware that ran AT%KEYGEN=101 instead of 102.
     * The modem searches sec_tag_list [100,101,102] for a private key and
     * picks the first match — if 101 has an old mismatched key it is used
     * for TLS auth, failing with -104 (ECONNRESET) from AWS. */
    delete_if_exists(CONFIG_STRATUS_DEVICE_CERT_TAG,
                     MODEM_KEY_MGMT_CRED_TYPE_PRIVATE_CERT,
                     "stale key at cert tag (101)");
}

void cert_store_clear_all_device_creds(void)
{
    LOG_WRN("Clearing ALL device credentials (cert + key) for force-reprovision");
    delete_if_exists(CONFIG_STRATUS_DEVICE_CERT_TAG,
                     MODEM_KEY_MGMT_CRED_TYPE_PUBLIC_CERT,  "device cert");
    delete_if_exists(CONFIG_STRATUS_DEVICE_KEY_TAG,
                     MODEM_KEY_MGMT_CRED_TYPE_PRIVATE_CERT, "device key");
    /* Clear legacy slots from pre-migration firmware */
    delete_if_exists(21, MODEM_KEY_MGMT_CRED_TYPE_PUBLIC_CERT,  "device cert (old tag 21)");
    delete_if_exists(22, MODEM_KEY_MGMT_CRED_TYPE_PRIVATE_CERT, "device key (old tag 22)");
    /* Clear stale key at DEVICE_CERT_TAG (101) left by old AT%KEYGEN=101 runs */
    if (CONFIG_STRATUS_DEVICE_CERT_TAG != CONFIG_STRATUS_DEVICE_KEY_TAG) {
        delete_if_exists(CONFIG_STRATUS_DEVICE_CERT_TAG,
                         MODEM_KEY_MGMT_CRED_TYPE_PRIVATE_CERT,
                         "stale key at cert tag");
    }
}
int cert_store_write_device_creds(const char *cert, const char *key)
{
    if (!cert || !key) {
        return -EINVAL;
    }

    /* Always delete first — modem_key_mgmt_write returns -EACCES if
     * the slot already has a credential on some modem firmware versions. */
    delete_if_exists(CONFIG_STRATUS_DEVICE_CERT_TAG,
                     MODEM_KEY_MGMT_CRED_TYPE_PUBLIC_CERT, "device cert");
    delete_if_exists(CONFIG_STRATUS_DEVICE_KEY_TAG,
                     MODEM_KEY_MGMT_CRED_TYPE_PRIVATE_CERT, "device key");

    int ret = modem_key_mgmt_write(CONFIG_STRATUS_DEVICE_CERT_TAG,
                                   MODEM_KEY_MGMT_CRED_TYPE_PUBLIC_CERT,
                                   cert, strlen(cert));
    if (ret) {
        LOG_ERR("Failed to write device cert: %d", ret);
        return ret;
    }
    LOG_INF("Device cert written (tag %d)", CONFIG_STRATUS_DEVICE_CERT_TAG);

    ret = modem_key_mgmt_write(CONFIG_STRATUS_DEVICE_KEY_TAG,
                               MODEM_KEY_MGMT_CRED_TYPE_PRIVATE_CERT,
                               key, strlen(key));
    if (ret) {
        LOG_ERR("Failed to write device key: %d", ret);
        return ret;
    }
    LOG_INF("Device key written (tag %d)", CONFIG_STRATUS_DEVICE_KEY_TAG);

    return 0;
}

bool cert_store_device_creds_exist(void)
{
    bool cert_exists = false;
    bool key_exists  = false;

    int ret = modem_key_mgmt_exists(CONFIG_STRATUS_DEVICE_CERT_TAG,
                                    MODEM_KEY_MGMT_CRED_TYPE_PUBLIC_CERT,
                                    &cert_exists);
    if (ret) {
        LOG_WRN("modem_key_mgmt_exists (cert, tag %d) failed (%d) — assuming not provisioned",
                CONFIG_STRATUS_DEVICE_CERT_TAG, ret);
        return false;
    }

    ret = modem_key_mgmt_exists(CONFIG_STRATUS_DEVICE_KEY_TAG,
                                MODEM_KEY_MGMT_CRED_TYPE_PRIVATE_CERT,
                                &key_exists);
    if (ret) {
        LOG_WRN("modem_key_mgmt_exists (key, tag %d) failed (%d) — assuming not provisioned",
                CONFIG_STRATUS_DEVICE_KEY_TAG, ret);
        return false;
    }

    /* Both must be present — cert without key (or vice versa) is unusable */
    return cert_exists && key_exists;
}
```

## src/cert_store.h
```c
/*
 * Copyright (c) 2026 Conexio Technologies, Inc.
 *
 * SPDX-License-Identifier: Apache-2.0
 */

#ifndef CERT_STORE_H
#define CERT_STORE_H

#include <stdbool.h>

/*
 * cert_store.h — Modem credential management
 *
 * CLAIM creds (tags 10-12): shared bootstrap, embedded in firmware.
 * DEVICE creds (tags 100-102): unique per-device, written by AWS during provisioning.
 *   Tags 100-102 match CONFIG_CONEXIO_CLOUD_CA_TAG/CERT_TAG/KEY_TAG in the
 *   main SDK so the app sample finds them after flashing over this firmware.
 */

/** Provision claim Root CA + cert + key into modem. Skips if already present. */
int cert_store_provision_claim_creds(void);

/** Delete device cert (tag 101) only — key at 102 preserved. Normal re-provision path. */
void cert_store_clear_device_creds(void);

/** Delete BOTH device cert (101) AND key (102). Force-reprovision recovery only. */
void cert_store_clear_all_device_creds(void);

/** Delete stale private key at DEVICE_CERT_TAG (101) if present.
 *  Left by old firmware that ran AT%KEYGEN=101 instead of 102.
 *  Safe to call on every boot — no-op if already clean. */
void cert_store_clean_stale_key_at_cert_tag(void);

/**
 * Write unique device cert + key issued by AWS.
 * Always deletes existing entries first to avoid -EACCES on re-provisioning.
 */
int cert_store_write_device_creds(const char *cert, const char *key);

/** True if device cert (tag 101) exists in modem — indicates provisioning done. */
bool cert_store_device_creds_exist(void);

#endif /* CERT_STORE_H */
```

## src/provision.h
```c
/*
 * Copyright (c) 2026 Conexio Technologies, Inc.
 *
 * SPDX-License-Identifier: Apache-2.0
 */

#ifndef PROVISION_H
#define PROVISION_H

#include <zephyr/net/mqtt.h>

/**
 * @brief Pre-generate the device key pair and CSR while modem is offline.
 *
 * Must be called BEFORE lte_lc_connect_async() — AT%KEYGEN requires
 * the modem to be in offline/AT-command mode (LTE not active).
 *
 * Generates an RSA-2048 key pair at CONFIG_STRATUS_DEVICE_CERT_TAG.
 * The private key stays in the modem's secure storage.
 * The CSR is cached internally for use by run_provisioning().
 *
 * Safe to call on every boot — if provisioning is already done,
 * run_provisioning() will not be called and the CSR is unused.
 *
 * @return 0 on success, negative errno on failure.
 */
int provision_prepare_csr(void);

/**
 * @brief Run the AWS Fleet Provisioning exchange.
 *
 * Requires provision_prepare_csr() to have been called first (while offline).
 * Connects to AWS IoT using claim credentials, calls
 * CreateCertificateFromCsr, then RegisterThing, then stores
 * the resulting device certificate via modem_key_mgmt.
 *
 * @param device_id  IMEI-derived device ID string.
 * @param client     Configured mqtt_client (claim creds, broker resolved).
 * @return 0 on success, negative errno on failure.
 */
int run_provisioning(const char *device_id, struct mqtt_client *client);

/** MQTT event handler for the provisioning session — call from client evt_cb. */
void provision_mqtt_evt_handler(struct mqtt_client *client,
                                const struct mqtt_evt *evt);

#endif /* PROVISION_H */
```
