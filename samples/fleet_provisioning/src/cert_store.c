/*
 * cert_store.c — Modem credential management
 * NCS v3.2.1 / nRF9151
 */

#include <zephyr/kernel.h>
#include <modem/modem_key_mgmt.h>
#include <zephyr/logging/log.h>
#include <string.h>

#include "cert_store.h"

LOG_MODULE_REGISTER(cert_store, LOG_LEVEL_INF);

/* Embedded bootstrap credentials — built from src/certs/ by CMakeLists.txt */
static const unsigned char aws_root_ca[] = {
#include "aws_root_ca.pem.inc"
};
static const unsigned char claim_cert[] = {
#include "claim_cert.pem.inc"
};
static const unsigned char claim_key[] = {
#include "claim_key.pem.inc"
};

/* ── Helpers ─────────────────────────────────────────────────────────────── */

/* Write only if the slot is empty. */
static int write_if_absent(int tag, enum modem_key_mgmt_cred_type type,
                            const unsigned char *data, size_t len,
                            const char *label)
{
    bool exists = false;

    modem_key_mgmt_exists(tag, type, &exists);
    if (exists) {
        LOG_INF("%s already in modem (tag %d) — skipping", label, tag);
        return 0;
    }
    int ret = modem_key_mgmt_write(tag, type, data, len);
    if (ret) {
        LOG_ERR("Failed to write %s (tag %d): %d", label, tag, ret);
    } else {
        LOG_INF("%s written (tag %d)", label, tag);
    }
    return ret;
}

/* Delete if present — ignores "not found". */
static void delete_if_exists(int tag, enum modem_key_mgmt_cred_type type,
                              const char *label)
{
    bool exists = false;

    modem_key_mgmt_exists(tag, type, &exists);
    if (!exists) {
        return;
    }
    int ret = modem_key_mgmt_delete(tag, type);
    if (ret) {
        LOG_WRN("Delete %s (tag %d) failed: %d — overwrite will be attempted",
                label, tag, ret);
    } else {
        LOG_INF("Deleted %s (tag %d)", label, tag);
    }
}

/* ── Public API ──────────────────────────────────────────────────────────── */

int cert_store_provision_claim_creds(void)
{
    int ret;

    LOG_INF("Provisioning claim credentials...");

    ret = write_if_absent(CONFIG_STRATUS_CLAIM_CA_TAG,
                          MODEM_KEY_MGMT_CRED_TYPE_CA_CHAIN,
                          aws_root_ca, sizeof(aws_root_ca) - 1,
                          "Root CA (claim)");
    if (ret) return ret;

    ret = write_if_absent(CONFIG_STRATUS_DEVICE_CA_TAG,
                          MODEM_KEY_MGMT_CRED_TYPE_CA_CHAIN,
                          aws_root_ca, sizeof(aws_root_ca) - 1,
                          "Root CA (device)");
    if (ret) return ret;

    ret = write_if_absent(CONFIG_STRATUS_CLAIM_CERT_TAG,
                          MODEM_KEY_MGMT_CRED_TYPE_PUBLIC_CERT,
                          claim_cert, sizeof(claim_cert) - 1,
                          "Claim certificate");
    if (ret) return ret;

    ret = write_if_absent(CONFIG_STRATUS_CLAIM_KEY_TAG,
                          MODEM_KEY_MGMT_CRED_TYPE_PRIVATE_CERT,
                          claim_key, sizeof(claim_key) - 1,
                          "Claim private key");
    if (ret) return ret;

    LOG_INF("Claim credentials ready");
    return 0;
}

void cert_store_clear_device_creds(void)
{
    LOG_INF("Clearing stale device credentials...");
    /* Delete only the public certificate at DEVICE_CERT_TAG (101).
     * Do NOT delete the private key at DEVICE_KEY_TAG (102) — it was
     * just generated by AT%KEYGEN in provision_prepare_csr() and must
     * be preserved for the TLS handshake after provisioning completes.
     * AT%KEYGEN already deletes and regenerates the key internally. */
    delete_if_exists(CONFIG_STRATUS_DEVICE_CERT_TAG,
                     MODEM_KEY_MGMT_CRED_TYPE_PUBLIC_CERT, "device cert");
    /* Also delete any stale PRIVATE KEY at DEVICE_CERT_TAG — this was left
     * by old builds that ran AT%KEYGEN=101 (cert tag) instead of 102 (key tag).
     * The modem searches sec_tag_list [100,101,102] for a private key and
     * picks the first match — if tag 101 has an old mismatched key it will
     * be used instead of the correct one at 102, causing TLS auth failure. */
    delete_if_exists(CONFIG_STRATUS_DEVICE_CERT_TAG,
                     MODEM_KEY_MGMT_CRED_TYPE_PRIVATE_CERT, "stale key at cert tag (101)");
    /* Clear old tag 21 slot from pre-migration firmware if still present */
    if (CONFIG_STRATUS_DEVICE_CERT_TAG != 21) {
        delete_if_exists(21, MODEM_KEY_MGMT_CRED_TYPE_PUBLIC_CERT, "device cert (old tag 21)");
    }
}

void cert_store_clean_stale_key_at_cert_tag(void)
{
    /* Delete private key at DEVICE_CERT_TAG (101) if present.
     * This key was left by old firmware that ran AT%KEYGEN=101 instead of 102.
     * The modem searches sec_tag_list [100,101,102] for a private key and
     * picks the first match — if 101 has an old mismatched key it is used
     * for TLS auth, failing with -104 (ECONNRESET) from AWS. */
    delete_if_exists(CONFIG_STRATUS_DEVICE_CERT_TAG,
                     MODEM_KEY_MGMT_CRED_TYPE_PRIVATE_CERT,
                     "stale key at cert tag (101)");
}

void cert_store_clear_all_device_creds(void)
{
    LOG_WRN("Clearing ALL device credentials (cert + key) for force-reprovision");
    delete_if_exists(CONFIG_STRATUS_DEVICE_CERT_TAG,
                     MODEM_KEY_MGMT_CRED_TYPE_PUBLIC_CERT,  "device cert");
    delete_if_exists(CONFIG_STRATUS_DEVICE_KEY_TAG,
                     MODEM_KEY_MGMT_CRED_TYPE_PRIVATE_CERT, "device key");
    /* Clear legacy slots from pre-migration firmware */
    delete_if_exists(21, MODEM_KEY_MGMT_CRED_TYPE_PUBLIC_CERT,  "device cert (old tag 21)");
    delete_if_exists(22, MODEM_KEY_MGMT_CRED_TYPE_PRIVATE_CERT, "device key (old tag 22)");
    /* Clear stale key at DEVICE_CERT_TAG (101) left by old AT%KEYGEN=101 runs */
    if (CONFIG_STRATUS_DEVICE_CERT_TAG != CONFIG_STRATUS_DEVICE_KEY_TAG) {
        delete_if_exists(CONFIG_STRATUS_DEVICE_CERT_TAG,
                         MODEM_KEY_MGMT_CRED_TYPE_PRIVATE_CERT,
                         "stale key at cert tag");
    }
}
int cert_store_write_device_creds(const char *cert, const char *key)
{
    if (!cert || !key) {
        return -EINVAL;
    }

    /* Always delete first — modem_key_mgmt_write returns -EACCES if
     * the slot already has a credential on some modem firmware versions. */
    delete_if_exists(CONFIG_STRATUS_DEVICE_CERT_TAG,
                     MODEM_KEY_MGMT_CRED_TYPE_PUBLIC_CERT, "device cert");
    delete_if_exists(CONFIG_STRATUS_DEVICE_KEY_TAG,
                     MODEM_KEY_MGMT_CRED_TYPE_PRIVATE_CERT, "device key");

    int ret = modem_key_mgmt_write(CONFIG_STRATUS_DEVICE_CERT_TAG,
                                   MODEM_KEY_MGMT_CRED_TYPE_PUBLIC_CERT,
                                   cert, strlen(cert));
    if (ret) {
        LOG_ERR("Failed to write device cert: %d", ret);
        return ret;
    }
    LOG_INF("Device cert written (tag %d)", CONFIG_STRATUS_DEVICE_CERT_TAG);

    ret = modem_key_mgmt_write(CONFIG_STRATUS_DEVICE_KEY_TAG,
                               MODEM_KEY_MGMT_CRED_TYPE_PRIVATE_CERT,
                               key, strlen(key));
    if (ret) {
        LOG_ERR("Failed to write device key: %d", ret);
        return ret;
    }
    LOG_INF("Device key written (tag %d)", CONFIG_STRATUS_DEVICE_KEY_TAG);

    return 0;
}

bool cert_store_device_creds_exist(void)
{
    bool cert_exists = false;
    bool key_exists  = false;

    int ret = modem_key_mgmt_exists(CONFIG_STRATUS_DEVICE_CERT_TAG,
                                    MODEM_KEY_MGMT_CRED_TYPE_PUBLIC_CERT,
                                    &cert_exists);
    if (ret) {
        LOG_WRN("modem_key_mgmt_exists (cert, tag %d) failed (%d) — assuming not provisioned",
                CONFIG_STRATUS_DEVICE_CERT_TAG, ret);
        return false;
    }

    ret = modem_key_mgmt_exists(CONFIG_STRATUS_DEVICE_KEY_TAG,
                                MODEM_KEY_MGMT_CRED_TYPE_PRIVATE_CERT,
                                &key_exists);
    if (ret) {
        LOG_WRN("modem_key_mgmt_exists (key, tag %d) failed (%d) — assuming not provisioned",
                CONFIG_STRATUS_DEVICE_KEY_TAG, ret);
        return false;
    }

    /* Both must be present — cert without key (or vice versa) is unusable */
    return cert_exists && key_exists;
}
