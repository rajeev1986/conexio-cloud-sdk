/*
 * cert_store.c — Modem credential management
 * NCS v3.2.1 / nRF9151
 */

#include <zephyr/kernel.h>
#include <modem/modem_key_mgmt.h>
#include <zephyr/logging/log.h>
#include <string.h>

#include "cert_store.h"

LOG_MODULE_REGISTER(cert_store, LOG_LEVEL_INF);

/* Embedded bootstrap credentials — built from src/certs/ by CMakeLists.txt */
static const unsigned char aws_root_ca[] = {
#include "aws_root_ca.pem.inc"
};
static const unsigned char claim_cert[] = {
#include "claim_cert.pem.inc"
};
static const unsigned char claim_key[] = {
#include "claim_key.pem.inc"
};

/* ── Helpers ─────────────────────────────────────────────────────────────── */

/* Write only if the slot is empty. */
static int write_if_absent(int tag, enum modem_key_mgmt_cred_type type,
                            const unsigned char *data, size_t len,
                            const char *label)
{
    bool exists = false;

    modem_key_mgmt_exists(tag, type, &exists);
    if (exists) {
        LOG_INF("%s already in modem (tag %d) — skipping", label, tag);
        return 0;
    }
    int ret = modem_key_mgmt_write(tag, type, data, len);
    if (ret) {
        LOG_ERR("Failed to write %s (tag %d): %d", label, tag, ret);
    } else {
        LOG_INF("%s written (tag %d)", label, tag);
    }
    return ret;
}

/* Delete if present — ignores "not found". */
static void delete_if_exists(int tag, enum modem_key_mgmt_cred_type type,
                              const char *label)
{
    bool exists = false;

    modem_key_mgmt_exists(tag, type, &exists);
    if (!exists) {
        return;
    }
    int ret = modem_key_mgmt_delete(tag, type);
    if (ret) {
        LOG_WRN("Delete %s (tag %d) failed: %d — overwrite will be attempted",
                label, tag, ret);
    } else {
        LOG_INF("Deleted %s (tag %d)", label, tag);
    }
}

/* ── Public API ──────────────────────────────────────────────────────────── */

int cert_store_provision_claim_creds(void)
{
    int ret;

    LOG_INF("Provisioning claim credentials...");

    ret = write_if_absent(CONFIG_STRATUS_CLAIM_CA_TAG,
                          MODEM_KEY_MGMT_CRED_TYPE_CA_CHAIN,
                          aws_root_ca, sizeof(aws_root_ca) - 1,
                          "Root CA (claim)");
    if (ret) return ret;

    ret = write_if_absent(CONFIG_STRATUS_DEVICE_CA_TAG,
                          MODEM_KEY_MGMT_CRED_TYPE_CA_CHAIN,
                          aws_root_ca, sizeof(aws_root_ca) - 1,
                          "Root CA (device)");
    if (ret) return ret;

    ret = write_if_absent(CONFIG_STRATUS_CLAIM_CERT_TAG,
                          MODEM_KEY_MGMT_CRED_TYPE_PUBLIC_CERT,
                          claim_cert, sizeof(claim_cert) - 1,
                          "Claim certificate");
    if (ret) return ret;

    ret = write_if_absent(CONFIG_STRATUS_CLAIM_KEY_TAG,
                          MODEM_KEY_MGMT_CRED_TYPE_PRIVATE_CERT,
                          claim_key, sizeof(claim_key) - 1,
                          "Claim private key");
    if (ret) return ret;

    LOG_INF("Claim credentials ready");
    return 0;
}

void cert_store_clear_device_creds(void)
{
    LOG_INF("Clearing stale device credentials...");
    /* Only delete the public certificate — the private key at DEVICE_CERT_TAG
     * is regenerated by AT%KEYGEN in provision_prepare_csr() which runs
     * immediately after this call while the modem is still offline.
     * AT%KEYGEN deletes and regenerates the key internally. */
    delete_if_exists(CONFIG_STRATUS_DEVICE_CERT_TAG,
                     MODEM_KEY_MGMT_CRED_TYPE_PUBLIC_CERT, "device cert");
}

int cert_store_write_device_creds(const char *cert, const char *key)
{
    if (!cert || !key) {
        return -EINVAL;
    }

    /* Always delete first — modem_key_mgmt_write returns -EACCES if
     * the slot already has a credential on some modem firmware versions. */
    delete_if_exists(CONFIG_STRATUS_DEVICE_CERT_TAG,
                     MODEM_KEY_MGMT_CRED_TYPE_PUBLIC_CERT, "device cert");
    delete_if_exists(CONFIG_STRATUS_DEVICE_KEY_TAG,
                     MODEM_KEY_MGMT_CRED_TYPE_PRIVATE_CERT, "device key");

    int ret = modem_key_mgmt_write(CONFIG_STRATUS_DEVICE_CERT_TAG,
                                   MODEM_KEY_MGMT_CRED_TYPE_PUBLIC_CERT,
                                   cert, strlen(cert));
    if (ret) {
        LOG_ERR("Failed to write device cert: %d", ret);
        return ret;
    }
    LOG_INF("Device cert written (tag %d)", CONFIG_STRATUS_DEVICE_CERT_TAG);

    ret = modem_key_mgmt_write(CONFIG_STRATUS_DEVICE_KEY_TAG,
                               MODEM_KEY_MGMT_CRED_TYPE_PRIVATE_CERT,
                               key, strlen(key));
    if (ret) {
        LOG_ERR("Failed to write device key: %d", ret);
        return ret;
    }
    LOG_INF("Device key written (tag %d)", CONFIG_STRATUS_DEVICE_KEY_TAG);

    return 0;
}

bool cert_store_device_creds_exist(void)
{
    bool exists = false;

    int ret = modem_key_mgmt_exists(CONFIG_STRATUS_DEVICE_CERT_TAG,
                                    MODEM_KEY_MGMT_CRED_TYPE_PUBLIC_CERT,
                                    &exists);
    if (ret) {
        LOG_WRN("modem_key_mgmt_exists failed (%d) — assuming not provisioned", ret);
        return false;
    }
    return exists;
}
