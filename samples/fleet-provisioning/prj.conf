## CMakeLists.txt
```
cmake_minimum_required(VERSION 3.20.0)

find_package(Zephyr REQUIRED HINTS $ENV{ZEPHYR_BASE})
project(conexio_fleet_provisioning)

# ── Source files ──────────────────────────────────────────────────────────────
target_sources(app PRIVATE
  src/main.c
  src/provision.c
  src/cert_store.c
  src/uart_commissioning.c
)

# ── Embed the claim certificate (shared across all devices) ───────────────────
# Place claim.crt, claim.key, and AmazonRootCA1.pem in src/certs/ before building.
# These are the BOOTSTRAP credentials — NOT per-device.
# See README.md for instructions on obtaining them from AWS.

set(CERT_DIR ${CMAKE_CURRENT_SOURCE_DIR}/src/certs)

generate_inc_file_for_target(app
  ${CERT_DIR}/AmazonRootCA1.pem
  ${ZEPHYR_BINARY_DIR}/include/generated/aws_root_ca.pem.inc
)

generate_inc_file_for_target(app
  ${CERT_DIR}/claim.crt
  ${ZEPHYR_BINARY_DIR}/include/generated/claim_cert.pem.inc
)

generate_inc_file_for_target(app
  ${CERT_DIR}/claim.key
  ${ZEPHYR_BINARY_DIR}/include/generated/claim_key.pem.inc
)
```

## Kconfig
```
mainmenu "Conexio Console Fleet Provisioning Sample"

config CONEXIO_AWS_BROKER_HOSTNAME
	string "AWS IoT Core MQTT endpoint"
	default "ENDPOINT.iot.us-east-1.amazonaws.com"
	help
	  Get this from:
	    aws iot describe-endpoint --endpoint-type iot:Data-ATS
	  Example: abc123xyz.iot.us-east-1.amazonaws.com
	  This is the SAME endpoint for both provisioning and normal operation.
	  It is shared by all devices — no per-device configuration needed here.

config CONEXIO_FLEET_TEMPLATE_NAME
	string "AWS IoT Fleet Provisioning template name"
	default "ConexioFleetTemplate"
	help
	  Must match the template name you created in AWS IoT (or the one
	  created by deploy.sh / CDK). This is embedded in the MQTT topic:
	    $aws/provisioning-templates/<name>/provision/json

config CONEXIO_TELEMETRY_INTERVAL_SEC
	int "Telemetry publish interval in seconds"
	default 60
	range 10 3600
	help
	  How often to read sensors and publish telemetry to AWS after
	  provisioning is complete.

config CONEXIO_MQTT_KEEPALIVE_SEC
	int "MQTT keepalive interval in seconds"
	default 120
	range 30 600

config CONEXIO_FW_VERSION
	string "Firmware version string reported during UART commissioning"
	default "1.0.0"
	help
	  Version string sent in the info response to the Conexio Console
	  dashboard during USB/Serial commissioning. Update this for each
	  firmware release. Format: "<major>.<minor>.<patch>"

# ── Credential storage tags in modem secure storage ──────────────────────────
# Claim creds (tags 10-12): bootstrap certs embedded in firmware, read-only.
# Device creds (tags 20-22): issued by AWS during provisioning, written once.
# Keeping them in separate tag ranges makes it easy to check which phase
# the device is in, and to wipe only the claim certs after provisioning.

config CONEXIO_CLAIM_CA_TAG
	int "Modem TLS tag for Root CA (claim phase)"
	default 10

config CONEXIO_CLAIM_CERT_TAG
	int "Modem TLS tag for claim certificate"
	default 11

config CONEXIO_CLAIM_KEY_TAG
	int "Modem TLS tag for claim private key"
	default 12

config CONEXIO_DEVICE_CA_TAG
	int "Modem TLS tag for Root CA (device phase)"
	default 20

config CONEXIO_DEVICE_CERT_TAG
	int "Modem TLS tag for device certificate (issued by AWS)"
	default 21

config CONEXIO_DEVICE_KEY_TAG
	int "Modem TLS tag for device private key (issued by AWS)"
	default 22

source "Kconfig.zephyr"
```

## prj.conf
```kconfig
# =============================================================================
# Conexio Console — Fleet Provisioning sample for nRF91xx
# nRF Connect SDK v3.2.1
#
# ONE binary for the entire fleet. No per-device configuration needed.
# The device derives its unique ID from the modem's IMEI at runtime.
# =============================================================================

# ── AWS endpoint (shared by all devices) ──────────────────────────────────────
CONFIG_CONEXIO_AWS_BROKER_HOSTNAME="a2t1ogibbsuad8-ats.iot.us-east-1.amazonaws.com"
# Get endpoint: aws iot describe-endpoint --endpoint-type iot:Data-ATS

# ── Fleet Provisioning template name (must match CDK/deploy.sh) ───────────────
CONFIG_CONEXIO_FLEET_TEMPLATE_NAME="ConexioFleetTemplate"

# ── Firmware version (reported during USB/Serial commissioning) ───────────────
CONFIG_CONEXIO_FW_VERSION="1.0.0"

# ── Telemetry interval after provisioning ─────────────────────────────────────
CONFIG_CONEXIO_TELEMETRY_INTERVAL_SEC=60

# ── LTE / modem ───────────────────────────────────────────────────────────────
CONFIG_NRF_MODEM_LIB=y
CONFIG_LTE_LINK_CONTROL=y

# ── Networking ────────────────────────────────────────────────────────────────
CONFIG_NETWORKING=y
CONFIG_NET_NATIVE=n
CONFIG_NET_SOCKETS=y
CONFIG_NET_SOCKETS_OFFLOAD=y

# ── TLS ───────────────────────────────────────────────────────────────────────
# NET_SECURITY and NET_SOCKETS_POSIX_NAMES were removed in NCS v2.x.
# Modem-offloaded TLS on nRF91xx is handled via MODEM_KEY_MGMT only.
CONFIG_TLS_CREDENTIALS=y
CONFIG_MODEM_KEY_MGMT=y

# ── MQTT ──────────────────────────────────────────────────────────────────────
CONFIG_MQTT_LIB=y
CONFIG_MQTT_LIB_TLS=y
CONFIG_MQTT_KEEPALIVE=120

# ── JSON (cJSON) ──────────────────────────────────────────────────────────────
CONFIG_CJSON_LIB=y

# ── Date/time ─────────────────────────────────────────────────────────────────
CONFIG_DATE_TIME=y
CONFIG_DATE_TIME_NTP=y

# ── Modem info (IMEI for device ID, RSSI for signal quality) ──────────────────
CONFIG_MODEM_INFO=y
CONFIG_MODEM_INFO_ADD_NETWORK=y

# ── Settings subsystem (persists provisioning state across reboots) ───────────
# Uses internal flash to store a single flag: "provisioned = true"
CONFIG_SETTINGS=y
CONFIG_SETTINGS_FCB=y
CONFIG_FCB=y
CONFIG_FLASH=y
CONFIG_FLASH_PAGE_LAYOUT=y
CONFIG_FLASH_MAP=y
CONFIG_MPU_ALLOW_FLASH_WRITE=y

# ── NVS flash (for persistent reboot counter) ─────────────────────────────────
# NVS and Settings/FCB share the same flash partition safely.
CONFIG_NVS=y

# ── Stack sizes ───────────────────────────────────────────────────────────────
CONFIG_MAIN_STACK_SIZE=8192
CONFIG_HEAP_MEM_POOL_SIZE=65536
CONFIG_SYSTEM_WORKQUEUE_STACK_SIZE=2048

# ── Logging ───────────────────────────────────────────────────────────────────
CONFIG_LOG=y
CONFIG_LOG_DEFAULT_LEVEL=3
CONFIG_LOG_BUFFER_SIZE=4096
CONFIG_UART_CONSOLE=y

# ── Reset on fatal errors ─────────────────────────────────────────────────────
CONFIG_RESET_ON_FATAL_ERROR=y

CONFIG_BOOTLOADER_MCUBOOT=y
```

## src/cert_store.c
```c
/*
 * cert_store.c — Modem credential management helpers
 *
 * nRF Connect SDK v3.2.1 / nRF91xx
 */

#include <zephyr/kernel.h>
#include <modem/modem_key_mgmt.h>
#include <zephyr/logging/log.h>
#include <string.h>

#include "cert_store.h"

LOG_MODULE_REGISTER(cert_store, LOG_LEVEL_INF);

/* ── Embedded claim (bootstrap) credentials ──────────────────────────────── */
/* These are generated at build time from src/certs/ by CMakeLists.txt.      */
/* They are SHARED across all devices — the same binary ships to every unit. */

static const unsigned char aws_root_ca[] = {
#include "aws_root_ca.pem.inc"
};

static const unsigned char claim_cert[] = {
#include "claim_cert.pem.inc"
};

static const unsigned char claim_key[] = {
#include "claim_key.pem.inc"
};

/* ── TLS tag constants (mirrors Kconfig defaults) ────────────────────────── */
#define CLAIM_CA_TAG    CONFIG_CONEXIO_CLAIM_CA_TAG
#define CLAIM_CERT_TAG  CONFIG_CONEXIO_CLAIM_CERT_TAG
#define CLAIM_KEY_TAG   CONFIG_CONEXIO_CLAIM_KEY_TAG
#define DEVICE_CA_TAG   CONFIG_CONEXIO_DEVICE_CA_TAG
#define DEVICE_CERT_TAG CONFIG_CONEXIO_DEVICE_CERT_TAG
#define DEVICE_KEY_TAG  CONFIG_CONEXIO_DEVICE_KEY_TAG

/* ─────────────────────────────────────────────────────────────────────────── */

static int write_if_absent(int tag,
                           enum modem_key_mgmt_cred_type type,
                           const unsigned char *data,
                           size_t len,
                           const char *label)
{
    bool exists = false;
    int ret = modem_key_mgmt_exists(tag, type, &exists);
    if (ret == 0 && exists) {
        LOG_INF("%s already in modem (tag %d) — skipping write", label, tag);
        return 0;
    }

    ret = modem_key_mgmt_write(tag, type, data, len);
    if (ret < 0) {
        LOG_ERR("Failed to write %s (tag %d, err %d)", label, tag, ret);
        return ret;
    }

    LOG_INF("%s provisioned (tag %d)", label, tag);
    return 0;
}

/* Delete a credential if it exists — ignores "not found" errors. */
static void delete_if_exists(int tag,
                             enum modem_key_mgmt_cred_type type,
                             const char *label)
{
    bool exists = false;
    int ret = modem_key_mgmt_exists(tag, type, &exists);
    if (ret != 0 || !exists) {
        return;
    }
    ret = modem_key_mgmt_delete(tag, type);
    if (ret < 0) {
        LOG_WRN("Failed to delete %s (tag %d, err %d) — will attempt overwrite", label, tag, ret);
    } else {
        LOG_INF("Deleted stale %s (tag %d)", label, tag);
    }
}

/* ─────────────────────────────────────────────────────────────────────────── */

int cert_store_provision_claim_creds(void)
{
    int ret;

    LOG_INF("Provisioning claim credentials...");

    /* Root CA — shared tag for both claim and device phases */
    ret = write_if_absent(CLAIM_CA_TAG,
                          MODEM_KEY_MGMT_CRED_TYPE_CA_CHAIN,
                          aws_root_ca,
                          sizeof(aws_root_ca) - 1,  /* exclude null terminator */
                          "Root CA (claim tag)");
    if (ret) return ret;

    /* Also write Root CA to the device tag so normal operation works
     * without an extra write after provisioning */
    ret = write_if_absent(DEVICE_CA_TAG,
                          MODEM_KEY_MGMT_CRED_TYPE_CA_CHAIN,
                          aws_root_ca,
                          sizeof(aws_root_ca) - 1,
                          "Root CA (device tag)");
    if (ret) return ret;

    /* Claim certificate */
    ret = write_if_absent(CLAIM_CERT_TAG,
                          MODEM_KEY_MGMT_CRED_TYPE_PUBLIC_CERT,
                          claim_cert,
                          sizeof(claim_cert) - 1,
                          "Claim certificate");
    if (ret) return ret;

    /* Claim private key */
    ret = write_if_absent(CLAIM_KEY_TAG,
                          MODEM_KEY_MGMT_CRED_TYPE_PRIVATE_CERT,
                          claim_key,
                          sizeof(claim_key) - 1,
                          "Claim private key");
    if (ret) return ret;

    LOG_INF("Claim credentials ready");
    return 0;
}

int cert_store_clear_device_creds(void)
{
    LOG_INF("Clearing any stale device credentials from modem...");
    delete_if_exists(DEVICE_CERT_TAG, MODEM_KEY_MGMT_CRED_TYPE_PUBLIC_CERT,  "device cert");
    delete_if_exists(DEVICE_KEY_TAG,  MODEM_KEY_MGMT_CRED_TYPE_PRIVATE_CERT, "device key");
    LOG_INF("Device credential slots cleared (tags %d/%d)",
            DEVICE_CERT_TAG, DEVICE_KEY_TAG);
    return 0;
}

int cert_store_write_device_creds(const char *cert, const char *key)
{
    int ret;

    if (!cert || !key) {
        return -EINVAL;
    }

    /* Always delete before writing — modem_key_mgmt_write() on a slot that
     * already contains a credential returns -EACCES on some modem FW versions.
     * Deleting first guarantees a clean write regardless of prior state. */
    delete_if_exists(DEVICE_CERT_TAG, MODEM_KEY_MGMT_CRED_TYPE_PUBLIC_CERT,  "device cert");
    delete_if_exists(DEVICE_KEY_TAG,  MODEM_KEY_MGMT_CRED_TYPE_PRIVATE_CERT, "device key");

    LOG_INF("Writing unique device certificate (tag %d)...", DEVICE_CERT_TAG);
    ret = modem_key_mgmt_write(DEVICE_CERT_TAG,
                               MODEM_KEY_MGMT_CRED_TYPE_PUBLIC_CERT,
                               cert,
                               strlen(cert));
    if (ret < 0) {
        LOG_ERR("Failed to write device cert (err %d)", ret);
        return ret;
    }

    LOG_INF("Writing unique device private key (tag %d)...", DEVICE_KEY_TAG);
    ret = modem_key_mgmt_write(DEVICE_KEY_TAG,
                               MODEM_KEY_MGMT_CRED_TYPE_PRIVATE_CERT,
                               key,
                               strlen(key));
    if (ret < 0) {
        LOG_ERR("Failed to write device key (err %d)", ret);
        return ret;
    }

    LOG_INF("Device credentials stored successfully");
    return 0;
}

bool cert_store_device_creds_exist(void)
{
    bool exists = false;
    int ret = modem_key_mgmt_exists(DEVICE_CERT_TAG,
                                    MODEM_KEY_MGMT_CRED_TYPE_PUBLIC_CERT,
                                    &exists);
    if (ret != 0) {
        /* Cannot determine — assume not provisioned, attempt provisioning */
        LOG_WRN("modem_key_mgmt_exists failed (err %d) — assuming not provisioned", ret);
        return false;
    }
    return exists;
}
```

## src/cert_store.h
```c
#ifndef CERT_STORE_H
#define CERT_STORE_H

#include <stdbool.h>

/*
 * cert_store.h — Modem credential management helpers
 *
 * Abstracts modem_key_mgmt read/write/exists so the rest of the firmware
 * doesn't need to care about TLS tag numbers or credential types.
 *
 * Two credential sets live in modem secure storage:
 *
 *   CLAIM (tags 10-12)  — shared bootstrap certs embedded in firmware.
 *                          Used only during the provisioning MQTT session.
 *   DEVICE (tags 20-22) — unique certs issued by AWS Fleet Provisioning.
 *                          Written once, used for all subsequent connections.
 */

/* ── Write claim (bootstrap) credentials ──────────────────────────────────── */

/**
 * @brief Provision claim Root CA, certificate, and private key into modem.
 *
 * Safe to call on every boot — checks modem_key_mgmt_exists() first and
 * skips writes when the creds are already present.
 *
 * @return 0 on success, negative errno on failure.
 */
int cert_store_provision_claim_creds(void);

/* ── Write device credentials (called once after provisioning) ───────────── */

/**
 * @brief Clear any stale device credentials from modem secure storage.
 *
 * Deletes device cert (tag 21) and device key (tag 22) if present.
 * Safe to call when the slots are already empty.
 * Call this before starting a fresh provisioning attempt to ensure
 * no partial credentials from a previous failed run interfere.
 *
 * @return 0 always (delete errors are logged as warnings, not fatal).
 */
int cert_store_clear_device_creds(void);

/**
 * @brief Store the unique device certificate issued by AWS Fleet Provisioning.
 *
 * Always deletes the existing credential before writing so that stale
 * entries from failed provisioning attempts never cause -EACCES errors.
 *
 * @param cert  PEM string (null-terminated).
 * @param key   PEM string (null-terminated).
 * @return 0 on success, negative errno on failure.
 */
int cert_store_write_device_creds(const char *cert, const char *key);

/* ── Check state ──────────────────────────────────────────────────────────── */

/**
 * @brief Return true if the device certificate (tag 21) is present in modem.
 *
 * Used at startup to decide which phase to enter:
 *   false → fleet provisioning phase (use claim creds)
 *   true  → normal operation phase   (use device creds)
 */
bool cert_store_device_creds_exist(void);

#endif /* CERT_STORE_H */
```

## src/provision.c
```c
/*
 * provision.c — AWS IoT Fleet Provisioning state machine
 *
 * nRF Connect SDK v3.2.1 / nRF91xx
 *
 * AWS Fleet Provisioning MQTT API topics:
 *
 *   Step 1 — CreateKeysAndCertificate
 *     Publish to:   $aws/certificates/create/json
 *     Subscribe to: $aws/certificates/create/json/accepted
 *                   $aws/certificates/create/json/rejected
 *     Response contains: certificatePem, privateKey, certificateOwnershipToken
 *
 *   Step 2 — RegisterThing
 *     Publish to:   $aws/provisioning-templates/<template>/provision/json
 *     Subscribe to: $aws/provisioning-templates/<template>/provision/json/accepted
 *                   $aws/provisioning-templates/<template>/provision/json/rejected
 *     Request contains: certificateOwnershipToken + templateParameters (deviceId, etc.)
 *     Response contains: thingName, deviceConfiguration
 */

#include <zephyr/kernel.h>
#include <zephyr/net/mqtt.h>
#include <zephyr/net/socket.h>
#include <zephyr/logging/log.h>
#include <cJSON.h>
#include <cJSON_os.h>
#include <string.h>
#include <stdio.h>

#include "provision.h"
#include "cert_store.h"

LOG_MODULE_REGISTER(provision, LOG_LEVEL_INF);

/* ── Topic strings ───────────────────────────────────────────────────────── */
#define TOPIC_CREATE_KEYS       "$aws/certificates/create/json"
#define TOPIC_CREATE_ACCEPTED   "$aws/certificates/create/json/accepted"
#define TOPIC_CREATE_REJECTED   "$aws/certificates/create/json/rejected"

/* RegisterThing topics are built at runtime using the template name */
static char topic_register[128];
static char topic_register_accepted[140];
static char topic_register_rejected[140];

/* ── Provisioning state machine ──────────────────────────────────────────── */
typedef enum {
    PROV_STATE_IDLE,
    PROV_STATE_WAITING_CREATE,      /* waiting for CreateKeysAndCertificate response */
    PROV_STATE_WAITING_REGISTER,    /* waiting for RegisterThing response */
    PROV_STATE_DONE,
    PROV_STATE_FAILED,
} prov_state_t;

static prov_state_t prov_state = PROV_STATE_IDLE;

/* ── Provisioning result buffers ─────────────────────────────────────────── */
/* Certificates can be ~1.5 KB each. Use static buffers to avoid heap churn. */
#define CERT_BUF_SIZE  2048
#define KEY_BUF_SIZE   2048
#define TOKEN_BUF_SIZE 512

static char s_certificate_pem[CERT_BUF_SIZE];
static char s_private_key[KEY_BUF_SIZE];
static char s_ownership_token[TOKEN_BUF_SIZE];
static char s_thing_name[64];

/* ── MQTT payload receive buffer ─────────────────────────────────────────── */
/* CreateKeysAndCertificate response contains cert PEM (~1.7 KB) +
 * private key PEM (~1.7 KB) + ownership token (~0.5 KB) + JSON overhead.
 * 6 KB gives comfortable headroom. */
#define PAYLOAD_BUF_SIZE 6144
static uint8_t payload_buf[PAYLOAD_BUF_SIZE];

/* ── Semaphore to signal provisioning completion to main loop ────────────── */
static K_SEM_DEFINE(prov_done_sem, 0, 1);

/* ─────────────────────────────────────────────────────────────────────────── */
/* Internal helpers                                                            */
/* ─────────────────────────────────────────────────────────────────────────── */

static int mqtt_publish_empty(struct mqtt_client *client, const char *topic)
{
    struct mqtt_publish_param msg = {
        .message.topic.qos        = MQTT_QOS_1_AT_LEAST_ONCE,
        .message.topic.topic.utf8 = (uint8_t *)topic,
        .message.topic.topic.size = strlen(topic),
        .message.payload.data     = (uint8_t *)"{}",
        .message.payload.len      = 2,
        .message_id               = (uint16_t)(k_uptime_get_32() & 0xFFFF),
        .dup_flag                 = 0,
        .retain_flag              = 0,
    };
    return mqtt_publish(client, &msg);
}

static int mqtt_publish_str(struct mqtt_client *client,
                            const char *topic,
                            const char *payload)
{
    struct mqtt_publish_param msg = {
        .message.topic.qos        = MQTT_QOS_1_AT_LEAST_ONCE,
        .message.topic.topic.utf8 = (uint8_t *)topic,
        .message.topic.topic.size = strlen(topic),
        .message.payload.data     = (uint8_t *)payload,
        .message.payload.len      = strlen(payload),
        .message_id               = (uint16_t)(k_uptime_get_32() & 0xFFFF),
        .dup_flag                 = 0,
        .retain_flag              = 0,
    };
    return mqtt_publish(client, &msg);
}

static int subscribe_provisioning_topics(struct mqtt_client *client)
{
    /* Subscribe to all four response topics at once */
    struct mqtt_topic topics[] = {
        {
            .topic = { .utf8 = (uint8_t *)TOPIC_CREATE_ACCEPTED,
                       .size = strlen(TOPIC_CREATE_ACCEPTED) },
            .qos = MQTT_QOS_1_AT_LEAST_ONCE,
        },
        {
            .topic = { .utf8 = (uint8_t *)TOPIC_CREATE_REJECTED,
                       .size = strlen(TOPIC_CREATE_REJECTED) },
            .qos = MQTT_QOS_1_AT_LEAST_ONCE,
        },
        {
            .topic = { .utf8 = (uint8_t *)topic_register_accepted,
                       .size = strlen(topic_register_accepted) },
            .qos = MQTT_QOS_1_AT_LEAST_ONCE,
        },
        {
            .topic = { .utf8 = (uint8_t *)topic_register_rejected,
                       .size = strlen(topic_register_rejected) },
            .qos = MQTT_QOS_1_AT_LEAST_ONCE,
        },
    };

    const struct mqtt_subscription_list sub_list = {
        .list       = topics,
        .list_count = ARRAY_SIZE(topics),
        .message_id = 100,
    };

    int ret = mqtt_subscribe(client, &sub_list);
    if (ret) {
        LOG_ERR("subscribe_provisioning_topics failed (err %d)", ret);
    } else {
        LOG_INF("Subscribed to all provisioning response topics");
    }
    return ret;
}

/* ─────────────────────────────────────────────────────────────────────────── */
/* Handle CreateKeysAndCertificate/accepted                                   */
/*                                                                             */
/* Response JSON:                                                              */
/* {                                                                           */
/*   "certificateId": "abc...",                                               */
/*   "certificatePem": "-----BEGIN CERTIFICATE-----\n...",                    */
/*   "privateKey": "-----BEGIN RSA PRIVATE KEY-----\n...",                    */
/*   "certificateOwnershipToken": "eyJ..."                                    */
/* }                                                                           */
/* ─────────────────────────────────────────────────────────────────────────── */

static void handle_create_accepted(struct mqtt_client *client,
                                   const char *payload,
                                   const char *device_id)
{
    LOG_INF("CreateKeysAndCertificate accepted — parsing response...");

    cJSON *root = cJSON_Parse(payload);
    if (!root) {
        LOG_ERR("Failed to parse CreateKeysAndCertificate response");
        prov_state = PROV_STATE_FAILED;
        k_sem_give(&prov_done_sem);
        return;
    }

    const char *cert  = cJSON_GetStringValue(cJSON_GetObjectItem(root, "certificatePem"));
    const char *key   = cJSON_GetStringValue(cJSON_GetObjectItem(root, "privateKey"));
    const char *token = cJSON_GetStringValue(cJSON_GetObjectItem(root, "certificateOwnershipToken"));

    if (!cert || !key || !token) {
        LOG_ERR("CreateKeysAndCertificate response missing required fields");
        cJSON_Delete(root);
        prov_state = PROV_STATE_FAILED;
        k_sem_give(&prov_done_sem);
        return;
    }

    /* Stash in static buffers for use in RegisterThing and cert_store */
    strncpy(s_certificate_pem, cert,  sizeof(s_certificate_pem) - 1);
    strncpy(s_private_key,     key,   sizeof(s_private_key) - 1);
    strncpy(s_ownership_token, token, sizeof(s_ownership_token) - 1);

    LOG_INF("Received unique certificate and private key from AWS");
    cJSON_Delete(root);

    /* ── Step 2: RegisterThing ───────────────────────────────────────────── */
    /* Send the ownership token + our device parameters so AWS can:
     *   - Activate the certificate
     *   - Create an IoT Thing with our device ID as the name
     *   - Attach the policy defined in the provisioning template
     */
    cJSON *req    = cJSON_CreateObject();
    cJSON *params = cJSON_CreateObject();

    cJSON_AddStringToObject(req, "certificateOwnershipToken", s_ownership_token);
    cJSON_AddItemToObject(req, "parameters", params);

    /* templateParameters — must match what your provisioning template expects.
     * The CDK template uses SerialNumber as the Thing name. */
    cJSON_AddStringToObject(params, "SerialNumber", device_id);

    char *req_str = cJSON_PrintUnformatted(req);
    cJSON_Delete(req);

    if (!req_str) {
        LOG_ERR("Failed to serialise RegisterThing request");
        prov_state = PROV_STATE_FAILED;
        k_sem_give(&prov_done_sem);
        return;
    }

    LOG_INF("Publishing RegisterThing request for device: %s", device_id);
    int ret = mqtt_publish_str(client, topic_register, req_str);
    cJSON_FreeString(req_str);

    if (ret) {
        LOG_ERR("RegisterThing publish failed (err %d)", ret);
        prov_state = PROV_STATE_FAILED;
        k_sem_give(&prov_done_sem);
        return;
    }

    prov_state = PROV_STATE_WAITING_REGISTER;
}

/* ─────────────────────────────────────────────────────────────────────────── */
/* Handle RegisterThing/accepted                                               */
/*                                                                             */
/* Response JSON:                                                              */
/* {                                                                           */
/*   "thingName": "123456789012345",                                 */
/*   "deviceConfiguration": {}                                                */
/* }                                                                           */
/* ─────────────────────────────────────────────────────────────────────────── */

static void handle_register_accepted(const char *payload)
{
    LOG_INF("RegisterThing accepted — provisioning complete");

    cJSON *root = cJSON_Parse(payload);
    if (root) {
        const char *name = cJSON_GetStringValue(cJSON_GetObjectItem(root, "thingName"));
        if (name) {
            strncpy(s_thing_name, name, sizeof(s_thing_name) - 1);
            LOG_INF("AWS Thing name: %s", s_thing_name);
        }
        cJSON_Delete(root);
    }

    /* Write the unique device credentials into modem secure storage.
     * After this call the device cert (tag 21) exists in the modem. */
    int ret = cert_store_write_device_creds(s_certificate_pem, s_private_key);
    if (ret) {
        LOG_ERR("Failed to store device credentials (err %d)", ret);
        prov_state = PROV_STATE_FAILED;
    } else {
        LOG_INF("Device credentials written to modem — provisioning successful");
        prov_state = PROV_STATE_DONE;
    }

    k_sem_give(&prov_done_sem);
}

/* ─────────────────────────────────────────────────────────────────────────── */
/* MQTT event handler — provisioning phase                                    */
/* ─────────────────────────────────────────────────────────────────────────── */

/* Forward declaration — device_id needed in handle_create_accepted */
static const char *g_device_id;

void provision_mqtt_event_handler(struct mqtt_client *client,
                                  const struct mqtt_evt *evt)
{
    int ret;

    switch (evt->type) {

    case MQTT_EVT_CONNACK:
        if (evt->result == 0) {
            LOG_INF("MQTT connected (provisioning session)");

            /* Subscribe first — wait for SUBACK before publishing.
             * This ensures we are in the poll loop and ready to receive
             * the CreateKeysAndCertificate response before AWS sends it. */
            ret = subscribe_provisioning_topics(client);
            if (ret) {
                prov_state = PROV_STATE_FAILED;
                k_sem_give(&prov_done_sem);
                break;
            }
            /* CreateKeysAndCertificate publish happens in MQTT_EVT_SUBACK */
        } else {
            LOG_ERR("MQTT CONNACK error %d (check claim cert is attached to a policy)", evt->result);
            prov_state = PROV_STATE_FAILED;
            k_sem_give(&prov_done_sem);
        }
        break;

    case MQTT_EVT_DISCONNECT:
        LOG_WRN("MQTT disconnected during provisioning (result %d)", evt->result);
        if (prov_state != PROV_STATE_DONE) {
            prov_state = PROV_STATE_FAILED;
            k_sem_give(&prov_done_sem);
        }
        break;

    case MQTT_EVT_PUBLISH: {
        const struct mqtt_publish_param *p = &evt->param.publish;
        size_t payload_len = p->message.payload.len;

        /* Extract topic string for routing */
        char topic[256] = {0};
        size_t topic_len = MIN(p->message.topic.topic.size, sizeof(topic) - 1);
        memcpy(topic, p->message.topic.topic.utf8, topic_len);

        LOG_INF("MQTT_EVT_PUBLISH: topic='%s' payload_len=%zu", topic, payload_len);

        /* Read payload — use full buffer size, AWS cert response is ~3.5 KB */
        size_t read_len = MIN(payload_len, sizeof(payload_buf) - 1);
        if (payload_len > sizeof(payload_buf) - 1) {
            LOG_WRN("Payload %zu bytes exceeds buffer %zu — truncating",
                    payload_len, sizeof(payload_buf) - 1);
        }
        ret = mqtt_read_publish_payload_blocking(client, payload_buf, read_len);
        if (ret < 0) {
            LOG_ERR("mqtt_read_publish_payload failed (err %d)", ret);
            /* Must still drain remaining bytes or MQTT stream gets out of sync */
            break;
        }
        payload_buf[ret] = '\0';
        LOG_INF("Payload read: %d bytes", ret);

        /* Send PUBACK */
        if (p->message.topic.qos == MQTT_QOS_1_AT_LEAST_ONCE) {
            struct mqtt_puback_param puback = { .message_id = p->message_id };
            mqtt_publish_qos1_ack(client, &puback);
        }

        /* Route to correct handler */
        if (strcmp(topic, TOPIC_CREATE_ACCEPTED) == 0) {
            handle_create_accepted(client, (char *)payload_buf, g_device_id);

        } else if (strcmp(topic, TOPIC_CREATE_REJECTED) == 0) {
            LOG_ERR("CreateKeysAndCertificate REJECTED: %s", payload_buf);
            LOG_ERR("Check that the claim certificate has an IoT policy with "
                    "iot:CreateKeysAndCertificate permission");
            prov_state = PROV_STATE_FAILED;
            k_sem_give(&prov_done_sem);

        } else if (strcmp(topic, topic_register_accepted) == 0) {
            handle_register_accepted((char *)payload_buf);

        } else if (strcmp(topic, topic_register_rejected) == 0) {
            LOG_ERR("RegisterThing REJECTED: %s", payload_buf);
            LOG_ERR("Check the Fleet Provisioning template and pre-provisioning hook Lambda");
            prov_state = PROV_STATE_FAILED;
            k_sem_give(&prov_done_sem);

        } else {
            LOG_DBG("Unhandled provisioning topic: %s", topic);
        }
        break;
    }

    case MQTT_EVT_PUBACK:
        LOG_DBG("PUBACK (id %d)", evt->param.puback.message_id);
        break;

    case MQTT_EVT_SUBACK:
        LOG_INF("SUBACK — provisioning topics subscribed, publishing CreateKeysAndCertificate...");
        /* Now safe to publish — we are subscribed and back in the poll loop */
        ret = mqtt_publish_empty(client, TOPIC_CREATE_KEYS);
        if (ret) {
            LOG_ERR("CreateKeysAndCertificate publish failed (err %d)", ret);
            prov_state = PROV_STATE_FAILED;
            k_sem_give(&prov_done_sem);
            break;
        }
        prov_state = PROV_STATE_WAITING_CREATE;
        break;

    case MQTT_EVT_PINGRESP:
        break;

    default:
        LOG_DBG("Unhandled MQTT event: %d", evt->type);
        break;
    }
}

/* ─────────────────────────────────────────────────────────────────────────── */
/* Public entry point                                                          */
/* ─────────────────────────────────────────────────────────────────────────── */

int run_provisioning(const char *device_id, struct mqtt_client *client)
{
    /* Build RegisterThing topic strings now that template name is known */
    snprintf(topic_register,
             sizeof(topic_register),
             "$aws/provisioning-templates/%s/provision/json",
             CONFIG_CONEXIO_FLEET_TEMPLATE_NAME);
    snprintf(topic_register_accepted,
             sizeof(topic_register_accepted),
             "$aws/provisioning-templates/%s/provision/json/accepted",
             CONFIG_CONEXIO_FLEET_TEMPLATE_NAME);
    snprintf(topic_register_rejected,
             sizeof(topic_register_rejected),
             "$aws/provisioning-templates/%s/provision/json/rejected",
             CONFIG_CONEXIO_FLEET_TEMPLATE_NAME);

    g_device_id = device_id;
    prov_state  = PROV_STATE_IDLE;

    LOG_INF("Starting Fleet Provisioning for device: %s", device_id);
    LOG_INF("Template: %s", CONFIG_CONEXIO_FLEET_TEMPLATE_NAME);

    /* Connect with claim credentials */
    int ret = mqtt_connect(client);
    if (ret) {
        LOG_ERR("mqtt_connect (provisioning) failed (err %d)", ret);
        return ret;
    }

    /* Drive MQTT until done or timeout (3 minutes).
     * AWS IoT TLS handshake on cellular can take 30-60s on first connect. */
    int64_t deadline_ms = k_uptime_get() + 180000;

    while (prov_state != PROV_STATE_DONE && prov_state != PROV_STATE_FAILED) {
        if (k_uptime_get() > deadline_ms) {
            LOG_ERR("Fleet Provisioning timed out after 3 minutes");
            mqtt_disconnect(client, NULL);
            return -ETIMEDOUT;
        }

        struct zsock_pollfd fds = {
            .fd     = client->transport.tls.sock,
            .events = ZSOCK_POLLIN,
        };
        ret = zsock_poll(&fds, 1, K_SECONDS(1).ticks);
        if (ret > 0 && (fds.revents & ZSOCK_POLLIN)) {
            ret = mqtt_input(client);
            if (ret) {
                LOG_WRN("mqtt_input error (%d)", ret);
            }
        }

        ret = mqtt_live(client);
        if (ret && ret != -EAGAIN) {
            LOG_WRN("mqtt_live error (%d)", ret);
        }
    }

    mqtt_disconnect(client, NULL);

    if (prov_state == PROV_STATE_DONE) {
        LOG_INF("Fleet Provisioning completed successfully");
        return 0;
    }

    return -EACCES;
}
```

## src/provision.h
```c
#ifndef PROVISION_H
#define PROVISION_H

/*
 * provision.h — AWS IoT Fleet Provisioning state machine
 *
 * Handles the full provisioning MQTT session:
 *   1. Connect to AWS IoT using claim (bootstrap) credentials
 *   2. Subscribe to the provisioning accepted/rejected response topics
 *   3. Publish a CreateKeysAndCertificate request
 *   4. Receive the new unique certificate + private key from AWS
 *   5. Publish a RegisterThing request (activates the new cert + creates Thing)
 *   6. Receive RegisterThing acceptance
 *   7. Write the unique cert + key into modem storage via cert_store
 *   8. Persist a "provisioned" flag in Settings so we skip this on next boot
 *
 * After run_provisioning() returns 0, the device must disconnect and reconnect
 * using the device credentials (tags 20-22) for normal MQTT operation.
 */

#include <zephyr/net/mqtt.h>

/**
 * @brief Execute the Fleet Provisioning flow.
 *
 * Blocking — drives the MQTT event loop internally until provisioning
 * completes or fails.
 *
 * @param device_id  The IMEI-derived device ID string. AWS uses this as the
 *                   Thing name in the provisioning template.
 * @param client     A pre-initialised (but not yet connected) mqtt_client.
 *                   Must be set up to use the CLAIM TLS tags (10-12).
 *
 * @return 0 on success.
 *         -ETIMEDOUT if AWS does not respond within the timeout.
 *         -EACCES    if AWS rejects the provisioning request.
 *         Other negative errno on MQTT/network failure.
 */
int run_provisioning(const char *device_id, struct mqtt_client *client);

#endif /* PROVISION_H */
```

## src/uart_commissioning.c
```c
/*
 * uart_commissioning.c — WebSerial commissioning protocol over UART
 *
 * nRF Connect SDK v3.2.1 / nRF91xx
 *
 * Receive JSON commands from the Conexio Console dashboard over UART
 * (sent by the browser WebSerial API), and respond with device info
 * or write provisioning credentials into the modem.
 */

#include <zephyr/kernel.h>
#include <zephyr/device.h>
#include <zephyr/drivers/uart.h>
#include <zephyr/logging/log.h>
#include <cJSON.h>
#include <cJSON_os.h>
#include <string.h>
#include <stdio.h>

#include "uart_commissioning.h"
#include "cert_store.h"

LOG_MODULE_REGISTER(uart_comm, LOG_LEVEL_INF);

/* ── UART device ─────────────────────────────────────────────────────────── */
/* Uses the same UART as RTT/logging on nRF91xx DK (UART0).                 */
/* On Thingy:91, UART1 is typically wired to the USB-UART bridge.           */
#define UART_DEV DEVICE_DT_GET(DT_NODELABEL(uart0))

/* ── Receive buffer ──────────────────────────────────────────────────────── */
/* The provision command payload can be ~4 KB (cert + key + endpoint).      */
#define RX_BUF_SIZE  4096
static char rx_buf[RX_BUF_SIZE];
static int  rx_pos = 0;

/* ── UART ISR callback ───────────────────────────────────────────────────── */
/* Accumulates characters into rx_buf until a '\n' is seen.                 */

static uart_comm_status_t pending_status = UART_COMM_IDLE;
static bool line_ready = false;

static void uart_cb(const struct device *dev, void *user_data)
{
    ARG_UNUSED(user_data);

    if (!uart_irq_update(dev) || !uart_irq_rx_ready(dev)) {
        return;
    }

    uint8_t c;
    while (uart_fifo_read(dev, &c, 1) == 1) {
        if (c == '\n' || c == '\r') {
            if (rx_pos > 0) {
                rx_buf[rx_pos] = '\0';
                line_ready = true;
                rx_pos = 0;
            }
        } else if (rx_pos < RX_BUF_SIZE - 1) {
            rx_buf[rx_pos++] = (char)c;
        } else {
            /* Overrun — discard buffer and start fresh */
            LOG_WRN("UART RX buffer overrun — discarding");
            rx_pos = 0;
        }
    }
}

/* ── Transmit a JSON response ────────────────────────────────────────────── */

static void uart_send_json(const struct device *dev, const char *json_str)
{
    /* Append newline so the dashboard knows the response is complete */
    size_t len = strlen(json_str);
    for (size_t i = 0; i < len; i++) {
        uart_poll_out(dev, json_str[i]);
    }
    uart_poll_out(dev, '\n');
}

static void send_ok(const struct device *dev, const char *message)
{
    char resp[128];
    snprintf(resp, sizeof(resp), "{\"status\":\"ok\",\"message\":\"%s\"}", message);
    uart_send_json(dev, resp);
}

static void send_error(const struct device *dev, const char *message)
{
    char resp[256];
    snprintf(resp, sizeof(resp), "{\"status\":\"error\",\"message\":\"%s\"}", message);
    uart_send_json(dev, resp);
    LOG_WRN("UART commissioning error: %s", message);
}

/* ── Handle "info" command ───────────────────────────────────────────────── */

static void handle_info(const struct device *dev,
                        const char *device_id,
                        const char *fw_version)
{
    bool already_provisioned = cert_store_device_creds_exist();

    char resp[256];
    snprintf(resp, sizeof(resp),
             "{\"status\":\"ok\","
             "\"type\":\"nrf91xx\","
             "\"fw\":\"%s\","
             "\"provisioned\":%s,"
             "\"deviceId\":\"%s\"}",
             fw_version,
             already_provisioned ? "true" : "false",
             device_id);

    uart_send_json(dev, resp);
    LOG_INF("Sent device info: id=%s, fw=%s, provisioned=%d",
            device_id, fw_version, (int)already_provisioned);
}

/* ── Handle "provision" command ──────────────────────────────────────────── */
/*                                                                            */
/* Expected JSON:                                                             */
/* {                                                                          */
/*   "cmd": "provision",                                                      */
/*   "deviceId": "351358811234567",                                 */
/*   "endpoint": "xxx.iot.us-east-1.amazonaws.com",                          */
/*   "cert": "-----BEGIN CERTIFICATE-----\n...",                              */
/*   "key":  "-----BEGIN RSA PRIVATE KEY-----\n...",                          */
/*   "rootCaUrl": "https://www.amazontrust.com/..."                           */
/* }                                                                          */

/* Persistent storage for the endpoint — written to settings/flash */
#include <zephyr/settings/settings.h>
#define ENDPOINT_SETTINGS_KEY "comm/endpoint"

static int handle_provision(const struct device *dev,
                             const cJSON *msg,
                             uart_comm_status_t *out_status)
{
    const char *cert     = cJSON_GetStringValue(cJSON_GetObjectItem(msg, "cert"));
    const char *key      = cJSON_GetStringValue(cJSON_GetObjectItem(msg, "key"));
    const char *endpoint = cJSON_GetStringValue(cJSON_GetObjectItem(msg, "endpoint"));
    const char *deviceId = cJSON_GetStringValue(cJSON_GetObjectItem(msg, "deviceId"));

    if (!cert || !key || !endpoint || !deviceId) {
        send_error(dev, "missing required fields: cert, key, endpoint, deviceId");
        *out_status = UART_COMM_ERROR;
        return -EINVAL;
    }

    LOG_INF("Received provision command for device: %s", deviceId);
    LOG_INF("AWS IoT endpoint: %s", endpoint);

    /* Write cert + key into modem secure storage */
    int ret = cert_store_write_device_creds(cert, key);
    if (ret) {
        send_error(dev, "failed to write credentials to modem");
        *out_status = UART_COMM_ERROR;
        return ret;
    }

    /* Persist the endpoint so main.c can use it after reboot */
    ret = settings_save_one(ENDPOINT_SETTINGS_KEY, endpoint, strlen(endpoint) + 1);
    if (ret) {
        LOG_WRN("Failed to persist endpoint (err %d) — using prj.conf value", ret);
        /* Non-fatal — device will use the compiled-in default endpoint */
    }

    send_ok(dev, "credentials stored, rebooting");
    LOG_INF("Credentials stored successfully — signalling main to reboot");

    *out_status = UART_COMM_PROVISIONED;
    return 0;
}

/* ── Public API ──────────────────────────────────────────────────────────── */

static const struct device *uart_dev;

int uart_commissioning_init(void)
{
    uart_dev = UART_DEV;

    if (!device_is_ready(uart_dev)) {
        LOG_ERR("UART device not ready");
        return -ENODEV;
    }

    uart_irq_callback_user_data_set(uart_dev, uart_cb, NULL);
    uart_irq_rx_enable(uart_dev);

    LOG_INF("UART commissioning handler ready (115200 baud)");
    LOG_INF("Waiting for dashboard connection...");
    return 0;
}

uart_comm_status_t uart_commissioning_poll(const char *device_id,
                                           const char *fw_version)
{
    if (!line_ready) {
        return UART_COMM_IDLE;
    }

    /* Snapshot the line and clear the flag */
    char line[RX_BUF_SIZE];
    strncpy(line, rx_buf, sizeof(line) - 1);
    line[sizeof(line) - 1] = '\0';
    line_ready = false;

    LOG_DBG("UART RX: %.*s", (int)MIN(strlen(line), 80), line);

    cJSON *msg = cJSON_Parse(line);
    if (!msg) {
        LOG_WRN("Failed to parse UART JSON: %.*s", (int)MIN(strlen(line), 80), line);
        send_error(uart_dev, "invalid JSON");
        return UART_COMM_ERROR;
    }

    const char *cmd = cJSON_GetStringValue(cJSON_GetObjectItem(msg, "cmd"));
    if (!cmd) {
        cJSON_Delete(msg);
        send_error(uart_dev, "missing 'cmd' field");
        return UART_COMM_ERROR;
    }

    uart_comm_status_t result = UART_COMM_IN_PROGRESS;

    if (strcmp(cmd, "info") == 0) {
        handle_info(uart_dev, device_id, fw_version);
        result = UART_COMM_IDLE; /* info exchange is stateless */

    } else if (strcmp(cmd, "provision") == 0) {
        handle_provision(uart_dev, msg, &result);

    } else {
        send_error(uart_dev, "unknown command");
        result = UART_COMM_ERROR;
    }

    cJSON_Delete(msg);
    return result;
}
```

## src/uart_commissioning.h
```c
#ifndef UART_COMMISSIONING_H
#define UART_COMMISSIONING_H

/*
 * uart_commissioning.h — WebSerial commissioning protocol over UART
 *
 * Implements the server side (device side) of the JSON-over-serial protocol
 * that the Conexio Console dashboard uses to provision credentials.
 *
 * Protocol (115200 baud, newline-delimited JSON):
 *
 *   Dashboard → Device:  {"cmd":"info"}
 *   Device → Dashboard:  {"status":"ok","type":"nrf91xx","fw":"1.2.0",
 *                          "provisioned":false,"deviceId":"nrf-imei-..."}
 *
 *   Dashboard → Device:  {"cmd":"provision","deviceId":"...","endpoint":"...",
 *                          "cert":"-----BEGIN CERTIFICATE...","key":"-----BEGIN RSA...",
 *                          "rootCaUrl":"https://..."}
 *   Device → Dashboard:  {"status":"ok","message":"credentials stored, rebooting"}
 *
 * Call uart_commissioning_init() once at startup.
 * Call uart_commissioning_poll() in your main loop before the MQTT connect.
 * Returns UART_COMM_PROVISIONED when the full provisioning flow completes.
 */

#include <stdbool.h>

typedef enum {
    UART_COMM_IDLE,         /* no commissioning in progress */
    UART_COMM_IN_PROGRESS,  /* received a cmd, processing */
    UART_COMM_PROVISIONED,  /* credentials written to modem — reboot required */
    UART_COMM_ERROR,        /* parse or storage error */
} uart_comm_status_t;

/**
 * @brief Initialise the UART commissioning handler.
 *
 * Configures the UART device for 115200 baud, 8N1.
 * Must be called once at startup, before uart_commissioning_poll().
 *
 * @return 0 on success, negative errno on failure.
 */
int uart_commissioning_init(void);

/**
 * @brief Poll for and handle incoming commissioning commands.
 *
 * Non-blocking. Returns immediately if no complete JSON line is available.
 * Call this in your main loop.
 *
 * @param device_id   The device's IMEI-derived ID (used in the info response).
 * @param fw_version  Firmware version string (e.g. "1.2.0").
 *
 * @return UART_COMM_IDLE         if nothing happened.
 *         UART_COMM_IN_PROGRESS  if a command was received and is being processed.
 *         UART_COMM_PROVISIONED  if credentials were written successfully.
 *         UART_COMM_ERROR        on a parse or storage error.
 */
uart_comm_status_t uart_commissioning_poll(const char *device_id,
                                           const char *fw_version);

#endif /* UART_COMMISSIONING_H */
```
