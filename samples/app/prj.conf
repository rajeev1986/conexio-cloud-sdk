## CMakeLists.txt
```
cmake_minimum_required(VERSION 3.20.0)

find_package(Zephyr REQUIRED HINTS $ENV{ZEPHYR_BASE})
project(app)

# Application sources
target_sources(app PRIVATE
  src/main.c
)

# ── cJSON include path ────────────────────────────────────────────────────────
target_include_directories(app PRIVATE
  ${ZEPHYR_CJSON_MODULE_DIR}
)

# ── Root CA cert ──────────────────────────────────────────────────────────────
# The Conexio Root CA (ConexioRootCA1.pem) is now embedded by the SDK itself.
# It lives in sdk/src/certs/ and is generated into conexio_root_ca.pem.inc
# by the SDK CMakeLists.txt — no entry needed here.
```

## Kconfig
```
mainmenu "Conexio Advanced Sample App"

# All production-grade feature configuration (PSM, FOTA, offline buffer,
# retry/watchdog) is defined in conexio-cloud-sdk/Kconfig under the
# CONFIG_CONEXIO_CLOUD_* namespace. Configure features via prj.conf.

config CONEXIO_SAMPLE_SIMULATED_SENSORS
	bool "Use simulated (random) sensor data"
	default y
	help
	  When enabled (default), temperature and humidity callbacks return
	  random values for demonstration purposes. A compiler warning is
	  emitted to prevent accidental production builds with fake data.

	  Set to n (CONFIG_CONEXIO_SAMPLE_SIMULATED_SENSORS=n in prj.conf)
	  and implement the real sensor reads in main.c before deploying
	  to production hardware.

source "Kconfig.zephyr"
```

## sysbuild.conf
```
#
# Copyright (c) 2025 Conexio Technologies, Inc
#
# SPDX-License-Identifier: Apache-2.0
#

SB_CONFIG_BOOTLOADER_MCUBOOT=y

# Project-specific FOTA signing key.
# SB_CONFIG_BOOT_SIGNATURE_KEY_FILE is the correct sysbuild variable — NCS
# passes it to west sign via image_signing.cmake. The path must be absolute
# because sysbuild resolves it from the west workspace root and MCUboot CMake
# does not double-prefix SB_CONFIG_ variables (unlike mcuboot.conf overrides).
# NEVER change this key after shipping devices without reflashing MCUboot.
SB_CONFIG_BOOT_SIGNATURE_KEY_FILE="/opt/nordic/ncs/v3.2.1/modules/lib/conexio-cloud-sdk/samples/app/keys/conexio-fota-signing.pem"
```

## prj.conf
```kconfig
# =============================================================================
# Conexio Advanced Sample App — prj.conf
#
# All production-grade features are now part of conexio-cloud-sdk-v2.
# Enable them here with CONFIG_CONEXIO_CLOUD_* options.
# The SDK handles all module initialisation internally.
#
# nRF Connect SDK v3.2.1 / nRF91xx
# =============================================================================

# ── Conexio Cloud SDK (Phase 2 — zero-config) ─────────────────────────────────
# No endpoint needed — fetched at runtime from config.conexio.io
CONFIG_CONEXIO_CLOUD=y
CONFIG_CONEXIO_CLOUD_MQTT=y
CONFIG_CONEXIO_CLOUD_INTERVAL_SEC=60

# ── Power Saving Mode (PSM) ───────────────────────────────────────────────────
# Modem sleeps between publishes (~2-3 µA vs ~6 mA idle connected).
# Typical battery improvement: 5-20x.
CONFIG_CONEXIO_CLOUD_PSM=y
CONFIG_CONEXIO_CLOUD_PSM_TAU_SEC=3600
CONFIG_CONEXIO_CLOUD_PSM_ACTIVE_TIME_SEC=10

# ── Offline telemetry buffer ───────────────────────────────────────────────────
# Buffers payloads in NVS flash when offline. Replays on reconnect.
CONFIG_CONEXIO_CLOUD_OFFLINE_BUFFER=y
CONFIG_CONEXIO_CLOUD_OFFLINE_BUFFER_SIZE=100
CONFIG_CONEXIO_CLOUD_OFFLINE_REPLAY_BATCH=10

# ── FOTA — Firmware Over-the-Air updates ──────────────────────────────────────
# Triggered by a FIRMWARE_UPDATE command from the Conexio Console Firmware page.
CONFIG_CONEXIO_CLOUD_FOTA=y
CONFIG_CONEXIO_CLOUD_FOTA_DOWNLOAD_TIMEOUT_SEC=300
# FOTA dependencies — explicit in NCS v3.2.1
CONFIG_BOOTLOADER_MCUBOOT=y
CONFIG_IMG_MANAGER=y
CONFIG_MCUBOOT_IMG_MANAGER=y
CONFIG_DFU_TARGET=y
CONFIG_DFU_TARGET_MCUBOOT=y
CONFIG_STREAM_FLASH=y
CONFIG_DOWNLOADER=y
CONFIG_FOTA_DOWNLOAD=y
CONFIG_FOTA_DOWNLOAD_PROGRESS_EVT=y

# ── Retry / watchdog ──────────────────────────────────────────────────────────
# Exponential backoff reconnect + hardware watchdog reboot on stall.
CONFIG_CONEXIO_CLOUD_RETRY=y
CONFIG_CONEXIO_CLOUD_RETRY_BASE_SEC=5
CONFIG_CONEXIO_CLOUD_RETRY_MAX_SEC=300
CONFIG_CONEXIO_CLOUD_RETRY_MAX_ATTEMPTS=10
CONFIG_CONEXIO_CLOUD_WATCHDOG_TIMEOUT_SEC=600

# ── LTE / Modem ───────────────────────────────────────────────────────────────
CONFIG_NRF_MODEM_LIB=y
CONFIG_LTE_LINK_CONTROL=y
CONFIG_LTE_LC_PSM_MODULE=y
CONFIG_LTE_LC_EDRX_MODULE=y
CONFIG_LTE_LC_MODEM_SLEEP_MODULE=y
CONFIG_MODEM_INFO=y
CONFIG_MODEM_INFO_ADD_NETWORK=y

# ── Networking ────────────────────────────────────────────────────────────────
CONFIG_NETWORKING=y
CONFIG_NET_NATIVE=n
CONFIG_NET_SOCKETS=y
CONFIG_NET_SOCKETS_OFFLOAD=y
CONFIG_TLS_CREDENTIALS=y
CONFIG_MODEM_KEY_MGMT=y
CONFIG_MQTT_LIB=y
CONFIG_MQTT_LIB_TLS=y
CONFIG_MQTT_KEEPALIVE=120
CONFIG_HTTP_CLIENT=y

# ── JSON ──────────────────────────────────────────────────────────────────────
CONFIG_CJSON_LIB=y

# ── Date/time ─────────────────────────────────────────────────────────────────
CONFIG_DATE_TIME=y
CONFIG_DATE_TIME_NTP=y

# ── Stack / heap ──────────────────────────────────────────────────────────────
CONFIG_MAIN_STACK_SIZE=8192
CONFIG_HEAP_MEM_POOL_SIZE=16384
CONFIG_SYSTEM_WORKQUEUE_STACK_SIZE=4096

# ── Logging ───────────────────────────────────────────────────────────────────
CONFIG_LOG=y
CONFIG_LOG_DEFAULT_LEVEL=3
CONFIG_UART_CONSOLE=y

# ── Reset on fatal ────────────────────────────────────────────────────────────
CONFIG_RESET_ON_FATAL_ERROR=y

# TF-M minimal profile (required for bootloader partition layout)
CONFIG_TFM_PROFILE_TYPE_MINIMAL=y
```

## prj_ingest_key.conf
```kconfig
# =============================================================================
# prj_ingest_key.conf — Ingest Key authentication overlay
#
# Developer quick-connect: authenticate via MQTT Custom Authorizer
# without fleet-provisioned TLS certificates.
#
# Usage:
#   west build -b conexio_stratus_pro/nrf9151/ns --pristine \
#              -- -DEXTRA_CONF_FILE=prj_ingest_key.conf
#
# Steps before building:
#   1. Register the device IMEI in Conexio Console → All Devices → + Add Device
#      (The IMEI is printed on the hardware label or read via: AT+CGSN)
#   2. Get an ingest key from Conexio Console → Organization → Ingest Keys
#   3. Replace the placeholder key value below — that's it
#
# ⚠ WARNING: Replace the placeholder value before building.
#            Never commit a file containing a real ingest key to version control.
#            Add your per-developer copy (e.g. prj_ingest_key_dev.conf) to .gitignore.
#
# How it works:
#   The device IMEI is read automatically from the modem at boot.
#   MQTT connects on port 8883 (standard TLS, no ALPN) to the ingest endpoint.
#   The endpoint (ingest.mqtt.cloud.conexiotech.com) is set as the SDK default
#   — no endpoint configuration needed for production builds.
#
#   MQTT fields set by firmware:
#     clientId  = IMEI
#     username  = IMEI
#     password  = ingest key (base64-encoded by IoT Core before Lambda sees it)
# =============================================================================

# ── Ingest Key ────────────────────────────────────────────────────────────────
# The only line you need to fill in.
# Paste the full key from Conexio Console → Organization → Ingest Keys.
# Format: cnx_<8chars>_<32chars>
CONFIG_CONEXIO_CLOUD_INGEST_KEY="ingest-key"
```

## boards/conexio_stratus_pro_nrf9151_ns.overlay
```dts
/*
 * Copyright (c) 2026 Conexio Technologies, Inc
 *
 * SPDX-License-Identifier: Apache-2.0
 *
 * Conexio Stratus Pro (nRF9151) overlay for the Conexio Cloud SDK sample app.
 *
 * LED GPIO — inherited from conexio_stratus_pro_common.dtsi:
 *   led0 alias → gpio0 pin 25, GPIO_ACTIVE_HIGH
 *
 * nPM1300 fuel gauge — I2C pull-ups for pmic_charger on i2c2:
 *   The nPM1300 PMIC (npm1300@6b) and its pmic_charger node are defined
 *   in conexio_stratus_pro_common.dtsi. Only the i2c2 pin pull-up needs
 *   to be enabled here to reliably communicate with the PMIC over I2C.
 *
 * nPM1300 NTC — the Stratus Pro does not have a thermistor physically
 *   connected to the NTC pin. thermistor-ohms = <0> tells the driver
 *   (npm13xx_charger.c) to write CHGR_OFFSET_DIS_SET bit 1 = 1, which
 *   disables the NTC comparator. Without this the charger halts because
 *   it sees an open circuit on the NTC pin and reports garbage temperature.
 *   This replaces the manual mfd_npm1300_reg_write() workaround needed in
 *   NCS ≤ v2.9.0 — the v3.2.1 driver handles it automatically via DTS.
 *
 * UART0 — low-power configuration:
 *   When building with low_power.conf (CONFIG_SERIAL=n / CONFIG_LOG=n),
 *   the UART RX pin is deleted to prevent current leakage through a
 *   floating or undriven RX line. TX is kept so the UART peripheral
 *   can still be held in a defined state by the hardware.
 */

/* Enable I2C pull-ups for nPM1300 PMIC communication */
&i2c2_default {
	group1 {
		bias-pull-up;
	};
};

/* nPM1300 charger — disable NTC (no thermistor populated on this board) */
&pmic_charger {
	thermistor-ohms = <0>;
	/delete-property/ thermistor-beta;
};

/* UART0 — delete RX pin to avoid floating-pin leakage in low-power builds */
&uart0 {
	status = "okay";
	current-speed = <115200>;
	/delete-property/ rx-pin;
};
```

## src/main.c
```c
/*
 * main.c — Conexio Advanced Sample Application
 *
 * nRF Connect SDK v3.2.1 / nRF91xx
 *
 * ┌─────────────────────────────────────────────────────────────────────────┐
 * │  This is what an application built on conexio-cloud-sdk looks like.    │
 * │                                                                         │
 * │  The application provides:                                              │
 * │    1. Sensor reading callbacks (registered — SDK calls them)            │
 * │    2. Actuator command handlers (FAN_ON, FAN_OFF)                       │
 * │    3. OTA Config settings handlers (alertThreshold, debugMode)          │
 * │    4. Optional cloud event handler (status LED etc.)                    │
 * │    5. main(): register → init → wait_connected → sleep loop             │
 * │                                                                         │
 * │  The SDK provides everything else — no boilerplate needed:              │
 * │    REBOOT, SET_INTERVAL, FIRMWARE_UPDATE commands — built-in            │
 * │    telemetryIntervalSec setting — built-in                              │
 * │    Retry, WDT, PSM, offline buffer, FOTA — enabled via prj.conf        │
 * │    _rssi, _snr, _reboot_cnt, _battery_mv, _sdk_version — auto-metrics  │
 * │    _app_fw_version — auto-published from app VERSION file               │
 * │    conexio_cloud_register_interval(min, max) — Golioth-style            │
 * │                                                                         │
 * │  Payload encoding (set in prj.conf):                                    │
 * │    CONFIG_CONEXIO_CLOUD_CBOR=y  — CBOR binary (default, ~50-70%        │
 * │                                   smaller than JSON on LTE-M/NB-IoT)   │
 * │    CONFIG_CONEXIO_CLOUD_CBOR=n  — JSON text (backwards-compatible)     │
 * │                                                                         │
 * │  The application code is 100% encoding-agnostic.  The same main.c,     │
 * │  sensor callbacks, and metric names work for both JSON and CBOR.        │
 * │  The SDK and cloud backend handle all encoding/decoding transparently.  │
 * └─────────────────────────────────────────────────────────────────────────┘
 */

/*
 * ONE include for everything — the SDK umbrella header automatically
 * includes fota.h, offline_buffer.h, power_mgr.h, retry.h based on Kconfig.
 */
#include <conexio_cloud/conexio_cloud.h>

/* ── Ingest key mode build-time checks ───────────────────────────────────────
 * When CONFIG_CONEXIO_CLOUD_INGEST_KEY is set, the device authenticates via
 * MQTT Custom Authorizer instead of TLS client cert.
 *
 * The device ID is automatically read from the modem IMEI at boot —
 * CONFIG_CONEXIO_CLOUD_STATIC_DEVICE_ID is NOT required and is ignored
 * when ingest key mode is active.
 */
#if defined(CONFIG_CONEXIO_CLOUD_INGEST_KEY_ENABLED)
#  warning "Ingest key mode active — device ID is the modem IMEI (port 8883, domain config, no ALPN)"
#  if defined(CONFIG_CONEXIO_CLOUD_STATIC_DEVICE_ID_ENABLED) && \
      CONFIG_CONEXIO_CLOUD_STATIC_DEVICE_ID_ENABLED
#    warning "CONFIG_CONEXIO_CLOUD_STATIC_DEVICE_ID_ENABLED is set but has no effect in ingest key mode — IMEI is used automatically"
#  endif
#endif

#include <zephyr/kernel.h>
#include <zephyr/drivers/gpio.h>
#include <zephyr/drivers/sensor.h>
#include <zephyr/random/random.h>
#include <zephyr/logging/log.h>

/* App firmware version from VERSION file — generated at build time */
#if __has_include(<app_version.h>)
#  include <app_version.h>
#else
#  define APP_VERSION_STRING "unknown"
#endif

/* Cellular location — collects AT%NCELLMEAS data for Conexio Location Service */
#if defined(CONFIG_CELL_LOCATION)
#include <conexio_cloud/cell_location.h>
#endif

LOG_MODULE_REGISTER(app, LOG_LEVEL_INF);

/* ── Application state ────────────────────────────────────────────────── */
static int  g_alert_threshold = 80;   /* temperature alert threshold (°C) */
static bool g_debug_mode      = false;
/* ── LED GPIO ─────────────────────────────────────────────────────────── */
/*
 * The Conexio Stratus Pro has one user-controllable LED:
 *   led0 → gpio0 pin 25, GPIO_ACTIVE_HIGH
 * Defined in the board DTS (conexio_stratus_pro_common.dtsi).
 * Accessible via the led0 alias — no overlay entry needed.
 */
#define LED0_NODE DT_ALIAS(led0)
static const struct gpio_dt_spec g_led = GPIO_DT_SPEC_GET(LED0_NODE, gpios);

/* ── Telemetry interval limits ────────────────────────────────────────── */
#define TELEMETRY_INTERVAL_MIN_S    10       /* Fastest: 10 s — debug / development   */
#define TELEMETRY_INTERVAL_MAX_S    604800   /* Slowest: 7 days — ultra-low-power      */

/* ── Alert threshold limits ───────────────────────────────────────────── */
#define ALERT_THRESHOLD_MIN         0        /* 0 = disabled                           */
#define ALERT_THRESHOLD_MAX         200      /* Covers full sensor range               */

/* ── Sensor callbacks ─────────────────────────────────────────────────── */
/*
 * These are called by the SDK background thread before each publish.
 * Replace the stub returns with your actual Zephyr sensor driver calls:
 *
 *   static double read_temperature(void *arg) {
 *       struct sensor_value val;
 *       sensor_sample_fetch(temp_dev);
 *       sensor_channel_get(temp_dev, SENSOR_CHAN_AMBIENT_TEMP, &val);
 *       return sensor_value_to_double(&val);
 *   }
 *
 * Return NAN to skip a reading for a given cycle (sensor unavailable).
 */

#if defined(CONFIG_CONEXIO_SAMPLE_SIMULATED_SENSORS)
/*
 * ⚠ SIMULATED SENSORS — for development and demonstration only.
 *
 * These callbacks return random values. They are compiled only when
 * CONFIG_CONEXIO_SAMPLE_SIMULATED_SENSORS=y (default in prj.conf).
 *
 * To use real sensors:
 *   1. Set CONFIG_CONEXIO_SAMPLE_SIMULATED_SENSORS=n in prj.conf
 *   2. Replace these stubs with actual Zephyr sensor driver calls
 *
 * A build warning is emitted below as a reminder.
 */
#warning "Simulated sensor data is enabled (CONFIG_CONEXIO_SAMPLE_SIMULATED_SENSORS=y)." \
         " Replace with real sensor reads before deploying to production."

static double read_temperature(void *arg)
{
    ARG_UNUSED(arg);
    /* Simulated: random value in [22.0, 35.0] °C with 0.1 resolution */
    double temp = 22.0 + (double)(sys_rand32_get() % 131) * 0.1;

    /* Publish an alert if the temperature exceeds the configured threshold.
     * conexio_cloud_publish_alert() sends immediately to the dedicated
     * v1/devices/{id}/alerts topic — separate from the regular telemetry
     * interval — so the cloud can trigger SNS notifications in real time. */
    if (g_alert_threshold > 0 && temp >= (double)g_alert_threshold) {
        conexio_cloud_publish_alert("temperature", temp,
                                    (double)g_alert_threshold);
    }
    return temp;
}

static double read_humidity(void *arg)
{
    ARG_UNUSED(arg);
    /* Simulated: random value in [50.0, 80.0] % with 0.1 resolution */
    return 50.0 + (double)(sys_rand32_get() % 301) * 0.1;
}

#else
/*
 * Real sensor reads — implement these for your hardware.
 * Returning NAN skips the metric for that publish cycle.
 */
static double read_temperature(void *arg)
{
    ARG_UNUSED(arg);
    /* TODO: implement for your sensor hardware
     * Example (BME280 / SHT31 / etc.):
     *   struct sensor_value val;
     *   sensor_sample_fetch(temp_dev);
     *   sensor_channel_get(temp_dev, SENSOR_CHAN_AMBIENT_TEMP, &val);
     *   double temp = sensor_value_to_double(&val);
     *   if (g_alert_threshold > 0 && temp >= (double)g_alert_threshold) {
     *       conexio_cloud_publish_alert("temperature", temp,
     *                                   (double)g_alert_threshold);
     *   }
     *   return temp;
     */
    return (double)NAN;
}

static double read_humidity(void *arg)
{
    ARG_UNUSED(arg);
    /* TODO: implement for your sensor hardware */
    return (double)NAN;
}
#endif /* CONFIG_CONEXIO_SAMPLE_SIMULATED_SENSORS */

/* ── Command handlers — hardware-specific only ────────────────────────── */
/*
 * REBOOT, SET_INTERVAL, FIRMWARE_UPDATE are registered automatically by
 * the SDK.  Only add handlers here for YOUR hardware commands.
 */

static void on_fan_on(const char *payload_json, void *arg)
{
    ARG_UNUSED(payload_json); ARG_UNUSED(arg);
    /* Payload example: {"speed": 80} — the SDK passes the raw JSON string.
     * Parse with cJSON if you need the speed value. */
    LOG_INF("FAN_ON");
    /* TODO: gpio_pin_set(fan_dev, FAN_PIN, 1); */
}

static void on_fan_off(const char *payload_json, void *arg)
{
    ARG_UNUSED(payload_json); ARG_UNUSED(arg);
    LOG_INF("FAN_OFF");
    /* TODO: gpio_pin_set(fan_dev, FAN_PIN, 0); */
}

/* ── LED command handlers ─────────────────────────────────────────────── */
/*
 * LED_ON  — turns on the on-board LED (gpio0 pin 25, ACTIVE_HIGH).
 * LED_OFF — turns off the on-board LED.
 *
 * These commands are used to test Device Schedules from the Conexio Console:
 *   1. Create a schedule with command = LED_ON  (start time)
 *   2. Create a schedule with command = LED_OFF (end time, or separate schedule)
 * The Schedules executor publishes the command via MQTT to
 *   devices/{deviceId}/commands  (QoS 1)
 * and the SDK dispatches it here.
 */
static void on_led_on(const char *payload_json, void *arg)
{
    ARG_UNUSED(payload_json); ARG_UNUSED(arg);
    int ret = gpio_pin_set_dt(&g_led, 1);
    if (ret != 0) {
        LOG_ERR("LED_ON: gpio_pin_set_dt failed (%d)", ret);
    } else {
        LOG_INF("LED_ON: LED is ON");
    }
}

static void on_led_off(const char *payload_json, void *arg)
{
    ARG_UNUSED(payload_json); ARG_UNUSED(arg);
    int ret = gpio_pin_set_dt(&g_led, 0);
    if (ret != 0) {
        LOG_ERR("LED_OFF: gpio_pin_set_dt failed (%d)", ret);
    } else {
        LOG_INF("LED_OFF: LED is OFF");
    }
    /* Cancel the firmware watchdog — stop command arrived from the cloud,
     * so the autonomous timer is no longer needed. This prevents a duplicate
     * LED_OFF from firing when the k_timer would have expired. */
    conexio_cloud_cancel_schedule_watchdog();
}

/* ── Schedule lifecycle callback ──────────────────────────────────────── */
/*
 * Called by the SDK for three events:
 *   STARTED  — cloud delivered LED_ON; firmware watchdog timer is now armed.
 *   STOPPED  — LED_OFF was fired by the firmware timer (device was offline).
 *   EXPIRED  — Device rebooted during LED_ON window; LED_OFF ran on boot.
 */
static void on_schedule(const struct conexio_schedule_event *evt)
{
    switch (evt->type) {
    case CONEXIO_SCHEDULE_EVT_STARTED:
        LOG_INF("Schedule watchdog armed — '%s' will fire autonomously at stopAt",
                evt->stop_command);
        break;
    case CONEXIO_SCHEDULE_EVT_STOPPED:
        LOG_INF("Schedule stopped autonomously — '%s' fired by firmware timer",
                evt->stop_command);
        break;
    case CONEXIO_SCHEDULE_EVT_EXPIRED:
        LOG_WRN("Schedule expired on boot — '%s' executed immediately",
                evt->stop_command);
        break;
    default:
        break;
    }
}

/* ── Settings handlers — app-specific keys only ───────────────────────── */
/*
 * telemetryIntervalSec is handled automatically by the SDK
 * (CONFIG_CONEXIO_CLOUD_AUTO_INTERVAL_SETTING=y).
 * Only register handlers for keys specific to your application.
 */

static enum conexio_setting_status on_alert_threshold(int32_t value, void *arg)
{
    ARG_UNUSED(arg);
    /* No range check needed — SDK validated against ALERT_THRESHOLD_MIN/MAX */
    g_alert_threshold = (int)value;
    LOG_INF("Setting: alertThreshold → %d", g_alert_threshold);
    return CONEXIO_SETTING_OK;
}

static enum conexio_setting_status on_debug_mode(bool value, void *arg)
{
    ARG_UNUSED(arg);
    g_debug_mode = value;
    LOG_INF("Setting: debugMode → %s", g_debug_mode ? "ON" : "OFF");
    return CONEXIO_SETTING_OK;
}

/* ── Cloud event handler — application reactions only ─────────────────── */
/*
 * The SDK handles all internal housekeeping before calling this:
 *   CONNECTED    → retry_on_success, buffer replay, fota_check_and_execute
 *   DISCONNECTED → retry_on_failure (with backoff)
 *   PUBLISHED    → power_mgr_sleep
 *   ERROR        → retry_on_failure
 *
 * Only add code here for app-level reactions (status LEDs, buzzer, etc.).
 * Pass NULL to conexio_cloud_init() if you have no app-level reactions.
 */
static void cloud_event_handler(const struct conexio_cloud_event *evt)
{
    switch (evt->type) {
    case CONEXIO_CLOUD_EVT_CONNECTED:
        LOG_INF("Connected — %s | App v%s | SDK v" CONEXIO_CLOUD_VERSION,
                conexio_cloud_device_id(), APP_VERSION_STRING);
        /* TODO: status LED green */
        break;
    case CONEXIO_CLOUD_EVT_DISCONNECTED:
        LOG_WRN("Disconnected");
        /* TODO: status LED red */
        break;
    case CONEXIO_CLOUD_EVT_PUBLISHED:
        LOG_DBG("Published");
        break;
    case CONEXIO_CLOUD_EVT_ERROR:
        LOG_ERR("Cloud error: %d", evt->data.error);
        break;
    default:
        break;
    }
}

/* ═══════════════════════════════════════════════════════════════════════════
 * main
 * ═══════════════════════════════════════════════════════════════════════════*/

int main(void)
{
    LOG_INF("=== Conexio Advanced Sample ===");
    LOG_INF("App v%s | SDK v" CONEXIO_CLOUD_VERSION, APP_VERSION_STRING);

    /* ── LED GPIO init ────────────────────────────────────────────────
     * Configure the on-board LED as output, initially OFF.
     * Must happen before conexio_cloud_init() so the LED is ready
     * when the first LED_ON/LED_OFF command arrives.              */
    if (!gpio_is_ready_dt(&g_led)) {
        LOG_ERR("LED GPIO device not ready");
    } else {
        int ret = gpio_pin_configure_dt(&g_led, GPIO_OUTPUT_INACTIVE);
        if (ret != 0) {
            LOG_ERR("LED GPIO configure failed (%d)", ret);
        } else {
            LOG_INF("LED GPIO ready (pin %d)", g_led.pin);
        }
    }

    /* ── Register sensor callbacks ────────────────────────────────────
     * The SDK calls these before each publish — no send_metric in loop. */
    conexio_cloud_register_sensor("temperature", read_temperature, NULL);
    conexio_cloud_register_sensor("humidity",    read_humidity,    NULL);
    /* ── Register application commands ───────────────────────────────
     * SDK built-ins: REBOOT, SET_INTERVAL, FIRMWARE_UPDATE
     * LED_ON / LED_OFF are used with Device Schedules to test
     * timed command delivery from the Conexio Console.             */
    conexio_cloud_register_command("FAN_ON",  on_fan_on,  NULL);
    conexio_cloud_register_command("FAN_OFF", on_fan_off, NULL);
    conexio_cloud_register_command("LED_ON",  on_led_on,  NULL);
    conexio_cloud_register_command("LED_OFF", on_led_off, NULL);

    /* ── Register application settings ───────────────────────────────
     * SDK built-in: telemetryIntervalSec (CONFIG_AUTO_INTERVAL_SETTING)
     *
     * Use _with_range variants to declare valid limits as named constants.
     * The SDK validates incoming values before calling your handler —
     * no range check needed in the callback.                           */
    conexio_cloud_register_setting_int_with_range("alertThreshold",
                                                  ALERT_THRESHOLD_MIN,
                                                  ALERT_THRESHOLD_MAX,
                                                  on_alert_threshold, NULL);
    conexio_cloud_register_setting_bool("debugMode", on_debug_mode, NULL);

    /* ── Register telemetry interval with limits ──────────────────────
     * The SDK validates any SET_INTERVAL or telemetryIntervalSec OTA
     * Config push against these limits — no range check in your code.
     * Values must be within CONFIG_CONEXIO_CLOUD_INTERVAL_SEC range.  */
    conexio_cloud_register_interval(TELEMETRY_INTERVAL_MIN_S,
                                    TELEMETRY_INTERVAL_MAX_S);

    /* ── Register schedule lifecycle callback ─────────────────────────
     * Called when the firmware watchdog arms, fires, or runs on boot.
     * The SDK stores the stop command + stopAt in NVS so LED_OFF runs
     * even if the device loses connectivity after receiving LED_ON.   */
    conexio_cloud_register_schedule_cb(on_schedule);

    /* ── Register FOTA maintenance window callback (optional) ────────────
     * Return false to defer a firmware download until the device is in a
     * safe state. The SDK retries every CONFIG_FOTA_PAUSE_RETRY_SEC (60s).
     *
     * Example: uncomment and implement safe_to_update() for your hardware:
     *
     *   static bool safe_to_update(void) {
     *       return !motor_is_running() && !measurement_in_progress();
     *   }
     *   conexio_cloud_set_fota_can_start_cb(safe_to_update);
     *
     * Without this, FOTA downloads start immediately when commanded.      */

    /* ── Single SDK init — handles everything ─────────────────────────
     * LTE → NTP → PSM decision → config fetch → transport init →
     * FOTA check → cloud thread spawn                                 */
    int ret = conexio_cloud_init(cloud_event_handler);
    if (ret) {
        LOG_ERR("conexio_cloud_init failed (%d)", ret);
        return -1;
    }

    /* ── Wait for MQTT connection then do boot publish ────────────────
     * conexio_cloud_wait_connected() blocks until MQTT CONNACK arrives
     * (or times out). Replaces the manual K_SEM_DEFINE boilerplate.
     *
     * conexio_cloud_publish() sends up to 4 separate MQTT messages to
     * their dedicated versioned topics:
     *   v1/.../diagnostics — SDK system metrics (always sent)
     *   v1/.../telemetry   — sensor callbacks + queued app metrics
     *   v1/.../location    — _loc_* metrics (if queued)
     *   v1/.../logs        — log entries (if LOG_STREAM=y and pending)
     * Boot-once metrics (_reboot_reason, _modem_fw, _session_id etc.)
     * are included in the diagnostics message on this first publish.  */
    LOG_INF("Waiting for MQTT connection...");
    if (conexio_cloud_wait_connected(60000) == 0) {
        LOG_INF("Boot publish — sending telemetry immediately after reset");
        /* Give the modem 2s to measure signal quality (RSRP) before publish */
        k_sleep(K_SECONDS(2));
        int pub_ret = conexio_cloud_publish();
        if (pub_ret) {
            LOG_WRN("Boot publish failed (%d) — will retry at next interval", pub_ret);
        }
    } else {
        LOG_WRN("MQTT connect timeout — skipping boot publish");
    }

#if defined(CONFIG_CELL_LOCATION)
    /* ── Cellular location init ───────────────────────────────────────
     * Registers the LTE LC event handler for AT%NCELLMEAS results.
     * Must run after LTE is connected (after conexio_cloud_init).
     *
     * No cell_location_request() on boot — the boot publish already sent
     * diagnostics once. The location k_work (PUBLISH_ON_FIX=y) only sends
     * the location topic, so periodic fixes are clean. The first measurement
     * fires automatically after CONFIG_CELL_LOCATION_INTERVAL_SEC seconds
     * via cell_location_tick() in the main loop below.                */
    cell_location_init();
#endif

    /* ── Main loop ────────────────────────────────────────────────────
     * The SDK background thread handles publishing, PSM, offline
     * buffering, reconnects, and FOTA. This loop just keeps main()
     * alive and wakes periodically to:
     *   - allow SET_INTERVAL / telemetryIntervalSec to take effect fast
     *   - call cell_location_tick() to drive the location interval
     *
     * Uses 5-second sleep so interval changes take effect within 5s
     * instead of waiting out the full current publish interval.       */
    while (1) {
        k_sleep(K_SECONDS(5));

#if defined(CONFIG_CELL_LOCATION)
        /* Advance the location interval countdown by 5 seconds.
         * cell_location_tick() fires cell_location_request() automatically
         * when CONFIG_CELL_LOCATION_INTERVAL_SEC seconds have elapsed.
         * No manual loop_count math needed — the SDK handles it.      */
        for (int i = 0; i < 5; i++) {
            cell_location_tick();
        }
#endif
    }

    return 0;
}
```

## src/cell_location.c
```c
/*
 * cell_location.c — Cellular positioning for AWS Location Service
 *
 * Copyright (c) 2026 Conexio Technologies, Inc.
 * SPDX-License-Identifier: Apache-2.0
 *
 * Collects LTE neighbor cell data via AT%NCELLMEAS and publishes it as
 * telemetry metrics. The cloud Lambda resolves the cell data to coordinates
 * using a positioning solver (HERE / Combain / Google Geolocation) and then
 * updates an AWS Location Tracker resource.
 *
 * Metric names sent in telemetry:
 *
 *   _loc_mcc          Mobile Country Code of serving cell  (int)
 *   _loc_mnc          Mobile Network Code of serving cell  (int)
 *   _loc_cell_id      E-UTRAN Cell ID of serving cell      (int)
 *   _loc_tac          Tracking Area Code                   (int)
 *   _loc_earfcn       EARFCN of serving cell               (int)
 *   _loc_rsrp         RSRP index of serving cell           (int)
 *                     Convert to dBm: RSRP_IDX_TO_DBM(idx)
 *   _loc_timing_adv   Timing advance (distance proxy)      (int, optional)
 *   _loc_neighbors    JSON array of neighbor cells         (string)
 *                     [{"earfcn":5110,"pci":42,"rsrp":55},...]
 *
 * All metrics use the "_loc_" prefix so the cloud can identify them as
 * location-related and route them to the positioning Lambda.
 *
 * Power note:
 *   AT%NCELLMEAS keeps the radio active for 1–5 seconds. Do not call it
 *   more often than needed — on a 60s publish interval, once per publish
 *   is fine for most tracking use cases. For ultra-low-power deployments,
 *   consider calling it only every N publishes (e.g. every 5 minutes).
 */

#include <zephyr/kernel.h>
#include <zephyr/logging/log.h>
#include <modem/lte_lc.h>
#include <cJSON.h>
#include <cJSON_os.h>
#include <string.h>
#include <conexio_cloud/conexio_cloud.h>

#include "cell_location.h"

LOG_MODULE_REGISTER(cell_location, LOG_LEVEL_INF);

/* ── State ────────────────────────────────────────────────────────────── */
static bool g_initialised = false;
static bool g_measurement_active = false;

/* ── RSRP raw index → dBm ─────────────────────────────────────────────
 * Per 3GPP TS 36.133: RSRP_dBm = index - 140  (for positive indices)
 * or                  RSRP_dBm = index + 140  (for negative, per nRF AT ref)
 * Using the same macro as NCS: RSRP_IDX_TO_DBM is defined in lte_lc.h.
 */
#ifndef RSRP_IDX_TO_DBM
#  define RSRP_IDX_TO_DBM(x) ((x) < 0 ? (x) - 140 : (x) - 141)
#endif

/* ── Serialize neighbor cells to compact JSON string ───────────────────
 *
 * Format: [{"earfcn":5110,"pci":42,"rsrp":-85},{"earfcn":5110,"pci":17,"rsrp":-90}]
 *
 * Kept compact (no whitespace) to minimize telemetry payload size.
 * Lambda parses this as a JSON array for the positioning API call.
 *
 * @param neighbors   Pointer to neighbor cell array
 * @param count       Number of entries
 * @param buf         Output buffer
 * @param buf_size    Size of output buffer
 * @return true on success, false if buffer too small or serialization failed
 */
static bool serialize_neighbors(const struct lte_lc_ncell *neighbors,
                                 uint8_t count,
                                 char *buf, size_t buf_size)
{
    if (!neighbors || count == 0 || !buf || buf_size == 0) {
        if (buf && buf_size > 2) {
            buf[0] = '['; buf[1] = ']'; buf[2] = '\0';
        }
        return true;
    }

    cJSON *arr = cJSON_CreateArray();
    if (!arr) return false;

    for (uint8_t i = 0; i < count; i++) {
        const struct lte_lc_ncell *n = &neighbors[i];
        cJSON *cell = cJSON_CreateObject();
        if (!cell) { cJSON_Delete(arr); return false; }

        cJSON_AddNumberToObject(cell, "earfcn", (double)n->earfcn);
        cJSON_AddNumberToObject(cell, "pci",    (double)n->phys_cell_id);
        /* Convert RSRP index to dBm for the Lambda */
        if (n->rsrp != LTE_LC_CELL_RSRP_INVALID) {
            cJSON_AddNumberToObject(cell, "rsrp", (double)RSRP_IDX_TO_DBM(n->rsrp));
        }
        cJSON_AddItemToArray(arr, cell);
    }

    char *json_str = cJSON_PrintUnformatted(arr);
    cJSON_Delete(arr);

    if (!json_str) return false;

    size_t len = strlen(json_str);
    bool ok = (len < buf_size);
    if (ok) {
        memcpy(buf, json_str, len + 1);
    } else {
        LOG_WRN("cell_location: neighbor buffer too small (%zu < %zu) — "
                "truncating to empty array", buf_size, len + 1);
        buf[0] = '['; buf[1] = ']'; buf[2] = '\0';
    }
    cJSON_free(json_str);
    return ok;
}

/* ── Process measurement result and queue telemetry metrics ────────────
 *
 * Called from the LTE LC event handler when NCELLMEAS completes.
 * Queues all location-related metrics via conexio_cloud_send_metric_*()
 * so they ride alongside the next regular telemetry publish.
 */
static void process_cell_measurement(const struct lte_lc_cells_info *cells)
{
    const struct lte_lc_cell *sc = &cells->current_cell;

    /* Validate serving cell — id == INVALID means the measurement failed */
    if (sc->id == LTE_LC_CELL_EUTRAN_ID_INVALID) {
        LOG_WRN("cell_location: measurement returned invalid cell ID — skipping");
        return;
    }

    LOG_INF("cell_location: measurement complete — MCC=%d MNC=%d CellID=%u "
            "TAC=%u EARFCN=%u RSRP=%d dBm neighbors=%u",
            sc->mcc, sc->mnc, sc->id, sc->tac, sc->earfcn,
            RSRP_IDX_TO_DBM(sc->rsrp), cells->ncells_count);

    /* ── Serving cell metrics ─────────────────────────────────────── */
    conexio_cloud_send_metric("_loc_mcc",      (double)sc->mcc);
    conexio_cloud_send_metric("_loc_mnc",      (double)sc->mnc);
    conexio_cloud_send_metric("_loc_cell_id",  (double)sc->id);
    conexio_cloud_send_metric("_loc_tac",      (double)sc->tac);
    conexio_cloud_send_metric("_loc_earfcn",   (double)sc->earfcn);

    /* RSRP: send the raw index — Lambda converts to dBm if needed,
     * but also send the dBm value for direct use. */
    if (sc->rsrp != LTE_LC_CELL_RSRP_INVALID) {
        conexio_cloud_send_metric("_loc_rsrp", (double)RSRP_IDX_TO_DBM(sc->rsrp));
    }

    /* Timing advance — useful for distance estimation (~100m resolution).
     * Only send when valid (INVALID means the modem doesn't have a fresh value). */
    if (sc->timing_advance != LTE_LC_CELL_TIMING_ADVANCE_INVALID) {
        conexio_cloud_send_metric("_loc_timing_adv", (double)sc->timing_advance);
    }

    /* ── Neighbor cells (JSON string metric) ──────────────────────── */
    if (cells->ncells_count > 0 && cells->neighbor_cells) {
        /* Buffer: each neighbor ~30 chars + overhead. 17 neighbors max = ~600 bytes */
        char nbuf[640];
        if (serialize_neighbors(cells->neighbor_cells,
                                cells->ncells_count,
                                nbuf, sizeof(nbuf))) {
            conexio_cloud_send_metric_str("_loc_neighbors", nbuf);
            LOG_DBG("cell_location: queued %u neighbor cells", cells->ncells_count);
        }
    }

    LOG_INF("cell_location: location metrics queued — will publish on next interval");
}

/* ── LTE LC event handler ──────────────────────────────────────────────
 *
 * Registered via lte_lc_register_handler(). Receives all LTE LC events
 * but only acts on LTE_LC_EVT_NEIGHBOR_CELL_MEAS.
 */
static void lte_lc_evt_handler(const struct lte_lc_evt *const evt)
{
    if (evt->type != LTE_LC_EVT_NEIGHBOR_CELL_MEAS) {
        return;
    }

    g_measurement_active = false;

    const struct lte_lc_cells_info *cells = &evt->cells_info;

    if (cells->current_cell.id == LTE_LC_CELL_EUTRAN_ID_INVALID) {
        LOG_WRN("cell_location: neighbor cell measurement failed or timed out");
        return;
    }

    process_cell_measurement(cells);
}

/* ── Public API ────────────────────────────────────────────────────────── */

int cell_location_init(void)
{
    if (g_initialised) {
        LOG_DBG("cell_location: already initialised");
        return 0;
    }

    /* lte_lc_register_handler() returns void in NCS v3.2.1 — no return value. */
    lte_lc_register_handler(lte_lc_evt_handler);

    g_initialised = true;
    LOG_INF("cell_location: initialised — ready to request measurements");
    return 0;
}

int cell_location_request(void)
{
    if (!g_initialised) {
        LOG_ERR("cell_location: not initialised — call cell_location_init() first");
        return -EINVAL;
    }

    if (g_measurement_active) {
        LOG_DBG("cell_location: measurement already in progress — skipping");
        return -EBUSY;
    }

    /* LTE_LC_NEIGHBOR_SEARCH_TYPE_DEFAULT: searches all supported bands.
     * Takes ~1–5 seconds. Finds up to 17 neighbor cells. */
    struct lte_lc_ncellmeas_params params = {
        .search_type = LTE_LC_NEIGHBOR_SEARCH_TYPE_DEFAULT,
        .gci_count   = 0,   /* not used with DEFAULT search type */
    };

    int ret = lte_lc_neighbor_cell_measurement(&params);
    if (ret) {
        LOG_ERR("cell_location: lte_lc_neighbor_cell_measurement failed (%d)", ret);
        return ret;
    }

    g_measurement_active = true;
    LOG_INF("cell_location: AT%%NCELLMEAS started — awaiting result...");
    return 0;
}

bool cell_location_is_busy(void)
{
    return g_measurement_active;
}
```

## src/cell_location.h
```c
/*
 * cell_location.h — Cellular positioning for AWS Location Service
 *
 * Copyright (c) 2026 Conexio Technologies, Inc.
 * SPDX-License-Identifier: Apache-2.0
 *
 * ┌────────────────────────────────────────────────────────────────────────┐
 * │  Architecture                                                          │
 * │                                                                        │
 * │  Device                 Cloud Lambda              AWS Location         │
 * │  ──────                 ─────────────             ────────────         │
 * │  AT%NCELLMEAS           receive telemetry         Tracker resource     │
 * │    → serving cell   ──► _loc_mcc, _loc_mnc    ──► BatchUpdateDevice   │
 * │    → N neighbors        _loc_cell_id, _loc_tac    Position             │
 * │    → RSRP / earfcn      _loc_rsrp                                     │
 * │                         _loc_neighbors (JSON)                          │
 * │                         call HERE / Combain API                        │
 * │                         get {lat, lng, accuracy}                       │
 * │                         push to AWS Location                           │
 * └────────────────────────────────────────────────────────────────────────┘
 *
 * The device side is intentionally thin:
 *   1. Trigger AT%NCELLMEAS when a location fix is wanted
 *   2. Collect the measurement result from the LTE LC event
 *   3. Serialize the data as telemetry metrics and queue them for publish
 *
 * No positioning solver runs on the device — the Lambda handles that.
 * This keeps the firmware simple and solver-agnostic.
 *
 * Usage:
 *   // Call once after LTE is connected and before main loop
 *   cell_location_init();
 *
 *   // Call whenever you want a location fix (e.g. on a timer, on demand)
 *   cell_location_request();
 *   // Metrics are queued automatically — next telemetry publish sends them
 */

#ifndef CELL_LOCATION_H_
#define CELL_LOCATION_H_

#include <stdbool.h>

#ifdef __cplusplus
extern "C" {
#endif

/**
 * @brief Initialise the cell location module.
 *
 * Registers the LTE LC event handler that listens for
 * LTE_LC_EVT_NEIGHBOR_CELL_MEAS results. Must be called after LTE is
 * connected (after conexio_cloud_init() returns).
 *
 * @return 0 on success, negative errno on failure.
 */
int cell_location_init(void);

/**
 * @brief Request a neighbor cell measurement.
 *
 * Triggers AT%NCELLMEAS. The result arrives asynchronously via
 * LTE_LC_EVT_NEIGHBOR_CELL_MEAS and is automatically queued as telemetry
 * metrics via conexio_cloud_send_metric().
 *
 * Non-blocking — returns immediately. The metrics will appear in the next
 * telemetry publish after the measurement completes (~1–5 seconds).
 *
 * Safe to call from any thread context.
 *
 * @return 0 on success, negative errno if measurement could not be started.
 */
int cell_location_request(void);

/**
 * @brief Returns true if a neighbor cell measurement is currently in progress.
 */
bool cell_location_is_busy(void);

#ifdef __cplusplus
}
#endif

#endif /* CELL_LOCATION_H_ */
```

## src/fuel_gauge.c
```c
/*
 * Copyright (c) 2023 Nordic Semiconductor ASA
 * SPDX-License-Identifier: LicenseRef-Nordic-5-Clause
 */

#include <stdlib.h>

#include <zephyr/kernel.h>
#include <zephyr/device.h>
#include <zephyr/drivers/sensor.h>
#include <zephyr/drivers/sensor/npm13xx_charger.h>
#include <zephyr/sys/printk.h>
#include <zephyr/sys/util.h>

#include <nrf_fuel_gauge.h>

/* nPM13xx CHARGER.BCHGCHARGESTATUS register bitmasks */
#define NPM13XX_CHG_STATUS_COMPLETE_MASK BIT(1)
#define NPM13XX_CHG_STATUS_TRICKLE_MASK  BIT(2)
#define NPM13XX_CHG_STATUS_CC_MASK       BIT(3)
#define NPM13XX_CHG_STATUS_CV_MASK       BIT(4)

static int64_t ref_time;

static const struct battery_model battery_model = {
#include "LP963450_25C.inc"
};

static int read_sensors(const struct device *charger, float *voltage, float *current, float *temp,
			int32_t *chg_status)
{
	struct sensor_value value;
	int ret;

	ret = sensor_sample_fetch(charger);
	if (ret < 0) {
		return ret;
	}

	sensor_channel_get(charger, SENSOR_CHAN_GAUGE_VOLTAGE, &value);
	*voltage = (float)value.val1 + ((float)value.val2 / 1000000);

	sensor_channel_get(charger, SENSOR_CHAN_GAUGE_TEMP, &value);
	*temp = (float)value.val1 + ((float)value.val2 / 1000000);

	sensor_channel_get(charger, SENSOR_CHAN_GAUGE_AVG_CURRENT, &value);
	*current = (float)value.val1 + ((float)value.val2 / 1000000);

	sensor_channel_get(charger, SENSOR_CHAN_NPM13XX_CHARGER_STATUS, &value);
	*chg_status = value.val1;

	return 0;
}

static int charge_status_inform(int32_t chg_status)
{
	union nrf_fuel_gauge_ext_state_info_data state_info;

	if (chg_status & NPM13XX_CHG_STATUS_COMPLETE_MASK) {
		printk("Charge complete\n");
		state_info.charge_state = NRF_FUEL_GAUGE_CHARGE_STATE_COMPLETE;
	} else if (chg_status & NPM13XX_CHG_STATUS_TRICKLE_MASK) {
		printk("Trickle charging\n");
		state_info.charge_state = NRF_FUEL_GAUGE_CHARGE_STATE_TRICKLE;
	} else if (chg_status & NPM13XX_CHG_STATUS_CC_MASK) {
		printk("Constant current charging\n");
		state_info.charge_state = NRF_FUEL_GAUGE_CHARGE_STATE_CC;
	} else if (chg_status & NPM13XX_CHG_STATUS_CV_MASK) {
		printk("Constant voltage charging\n");
		state_info.charge_state = NRF_FUEL_GAUGE_CHARGE_STATE_CV;
	} else {
		printk("Charger idle\n");
		state_info.charge_state = NRF_FUEL_GAUGE_CHARGE_STATE_IDLE;
	}

	return nrf_fuel_gauge_ext_state_update(NRF_FUEL_GAUGE_EXT_STATE_INFO_CHARGE_STATE_CHANGE,
					       &state_info);
}

int fuel_gauge_init(const struct device *charger)
{
	struct sensor_value value;
	struct nrf_fuel_gauge_init_parameters parameters = {
		.model = &battery_model,
		.opt_params = NULL,
		.state = NULL,
	};
	float max_charge_current;
	float term_charge_current;
	int32_t chg_status;
	int ret;

	printk("nRF Fuel Gauge version: %s\n", nrf_fuel_gauge_version);

	ret = read_sensors(charger, &parameters.v0, &parameters.i0, &parameters.t0, &chg_status);
	if (ret < 0) {
		return ret;
	}
	/* Zephyr sensor API convention for Gauge current is negative=discharging,
	 * while nrf_fuel_gauge lib expects the opposite negative=charging
	 */
	parameters.i0 = -parameters.i0;

	/* Store charge nominal and termination current, needed for ttf calculation */
	sensor_channel_get(charger, SENSOR_CHAN_GAUGE_DESIRED_CHARGING_CURRENT, &value);
	max_charge_current = (float)value.val1 + ((float)value.val2 / 1000000);
	term_charge_current = max_charge_current / 10.f;

	ret = nrf_fuel_gauge_init(&parameters, NULL);
	if (ret < 0) {
		printk("Error: Could not initialise fuel gauge\n");
		return ret;
	}

	ret = nrf_fuel_gauge_ext_state_update(NRF_FUEL_GAUGE_EXT_STATE_INFO_CHARGE_CURRENT_LIMIT,
					      &(union nrf_fuel_gauge_ext_state_info_data){
						      .charge_current_limit = max_charge_current});
	if (ret < 0) {
		printk("Error: Could not set fuel gauge state\n");
		return ret;
	}

	ret = nrf_fuel_gauge_ext_state_update(NRF_FUEL_GAUGE_EXT_STATE_INFO_TERM_CURRENT,
					      &(union nrf_fuel_gauge_ext_state_info_data){
						      .charge_term_current = term_charge_current});
	if (ret < 0) {
		printk("Error: Could not set fuel gauge state\n");
		return ret;
	}

	ret = charge_status_inform(chg_status);
	if (ret < 0) {
		printk("Error: Could not set fuel gauge state\n");
		return ret;
	}

	ref_time = k_uptime_get();

	return 0;
}

int fuel_gauge_update(const struct device *charger, bool vbus_connected)
{
	static int32_t chg_status_prev;

	float voltage;
	float current;
	float temp;
	float soc;
	float tte;
	float ttf;
	float delta;
	int32_t chg_status;
	int ret;

	ret = read_sensors(charger, &voltage, &current, &temp, &chg_status);
	if (ret < 0) {
		printk("Error: Could not read from charger device\n");
		return ret;
	}
	/* Zephyr sensor API convention for Gauge current is negative=discharging,
	 * while nrf_fuel_gauge lib expects the opposite negative=charging
	 */
	current = -current;

	ret = nrf_fuel_gauge_ext_state_update(
		vbus_connected ? NRF_FUEL_GAUGE_EXT_STATE_INFO_VBUS_CONNECTED
			       : NRF_FUEL_GAUGE_EXT_STATE_INFO_VBUS_DISCONNECTED,
		NULL);
	if (ret < 0) {
		printk("Error: Could not inform of state\n");
		return ret;
	}

	if (chg_status != chg_status_prev) {
		chg_status_prev = chg_status;

		ret = charge_status_inform(chg_status);
		if (ret < 0) {
			printk("Error: Could not inform of charge status\n");
			return ret;
		}
	}

	delta = (float)k_uptime_delta(&ref_time) / 1000.f;

	/* Zephyr sensor API convention for Gauge current is negative=discharging,
	 * while nrf_fuel_gauge lib expects the opposite negative=charging
	 */
	soc = nrf_fuel_gauge_process(voltage, -current, temp, delta, NULL);
	tte = nrf_fuel_gauge_tte_get();
	ttf = nrf_fuel_gauge_ttf_get();

	printk("V: %.3f, I: %.3f, T: %.2f, ", (double)voltage, (double)current, (double)temp);
	printk("SoC: %.2f, TTE: %.0f, TTF: %.0f\n", (double)soc, (double)tte, (double)ttf);

	return 0;
}
```
