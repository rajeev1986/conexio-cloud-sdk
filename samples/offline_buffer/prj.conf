## CMakeLists.txt
```
cmake_minimum_required(VERSION 3.20.0)
find_package(Zephyr REQUIRED HINTS $ENV{ZEPHYR_BASE})
project(offline_buffer)

target_sources(app PRIVATE src/main.c)
target_include_directories(app PRIVATE ${ZEPHYR_CJSON_MODULE_DIR})
```

## prj.conf
```kconfig
# =============================================================================
# Offline Buffer — Flash-backed telemetry buffering during connectivity loss
# =============================================================================
CONFIG_CONEXIO_CLOUD=y
CONFIG_CONEXIO_CLOUD_INTERVAL_SEC=30

# CBOR binary encoding
CONFIG_CONEXIO_CLOUD_CBOR=y
CONFIG_CONEXIO_CLOUD_CBOR_BUFFER_SIZE=512

# Offline buffer — stores telemetry in NVS flash when disconnected
CONFIG_CONEXIO_CLOUD_OFFLINE_BUFFER=y
# 50 entries × 30s interval = ~25 min of offline coverage
CONFIG_CONEXIO_CLOUD_OFFLINE_BUFFER_SIZE=50
# Replay 5 buffered entries per reconnect session
CONFIG_CONEXIO_CLOUD_OFFLINE_REPLAY_BATCH=5
# Discard entries older than 24 hours during replay
CONFIG_CONEXIO_CLOUD_OFFLINE_BUFFER_TTL_SEC=86400

# Retry
CONFIG_CONEXIO_CLOUD_RETRY=y

# Simulated sensors

# C library / system
CONFIG_POSIX_THREADS=y
CONFIG_MODEM_INFO_ADD_NETWORK=y
CONFIG_MODEM_INFO_ADD_DEVICE=y
CONFIG_MAIN_STACK_SIZE=4096
CONFIG_HEAP_MEM_POOL_SIZE=65536
CONFIG_SYSTEM_WORKQUEUE_STACK_SIZE=4096
CONFIG_CONEXIO_CLOUD_THREAD_STACK_SIZE=4096
CONFIG_LOG=y
CONFIG_LOG_DEFAULT_LEVEL=3
CONFIG_UART_CONSOLE=y
CONFIG_RESET_ON_FATAL_ERROR=y

# TF-M minimal profile (required for bootloader partition layout)
CONFIG_TFM_PROFILE_TYPE_MINIMAL=y
```

## src/main.c
```c
/*
 * Copyright (c) 2026 Conexio Technologies, Inc.
 *
 * SPDX-License-Identifier: Apache-2.0
 */

/*
 * offline_buffer/src/main.c — Offline telemetry buffering sample.
 *
 * Demonstrates how the Conexio Cloud SDK automatically buffers telemetry
 * payloads in NVS flash when the device loses LTE/MQTT connectivity, then
 * replays them to the cloud in chronological order on reconnect.
 *
 * How it works:
 *   - On every publish cycle, the SDK attempts to send telemetry via MQTT
 *   - If the connection is lost, the payload is written to an NVS ring buffer
 *   - On reconnect, the SDK replays buffered payloads (CONFIG_OFFLINE_REPLAY_BATCH
 *     per session) before resuming live telemetry
 *   - Payloads older than CONFIG_OFFLINE_BUFFER_TTL_SEC are silently discarded
 *     during replay to prevent stale data polluting the dashboard timeline
 *
 * This sample logs buffer status to help you observe the behaviour:
 *   - When offline: "Buffered: N/50 payloads in flash"
 *   - On reconnect: "Replaying N buffered payloads"
 *
 * Testing tip: block LTE connectivity (e.g. place in a shielded enclosure
 * or set CONFIG_CONEXIO_CLOUD_LTE_TIMEOUT_SEC=5 to force early timeout) and
 * observe buffer entries accumulating, then restore connectivity and watch
 * the replay sequence.
 *
 * Buffer parameters (set in prj.conf):
 *   CONFIG_CONEXIO_CLOUD_OFFLINE_BUFFER_SIZE=50    — max entries in ring buffer
 *   CONFIG_CONEXIO_CLOUD_OFFLINE_REPLAY_BATCH=5    — entries replayed per reconnect
 *   CONFIG_CONEXIO_CLOUD_OFFLINE_BUFFER_TTL_SEC=86400 — discard after 24 hours
 */

#include <conexio_cloud/conexio_cloud.h>
#include <zephyr/kernel.h>
#include <zephyr/random/random.h>
#include <zephyr/logging/log.h>

#if __has_include(<app_version.h>)
#  include <app_version.h>
#else
#  define APP_VERSION_STRING "1.0.0"
#endif

LOG_MODULE_REGISTER(app, LOG_LEVEL_INF);

/* ── Sensor callback ─────────────────────────────────────────────────── */
static double read_temperature(void *arg)
{
    ARG_UNUSED(arg);
    return 20.0 + (double)(sys_rand32_get() % 200) * 0.1;
}

/* ── Buffer-full callback (optional) ─────────────────────────────────────
 * Called when the ring buffer is full and the oldest entry is being dropped.
 * Useful for alerting, LED indicators, or stopping data collection.
 * Enable in prj.conf: CONFIG_CONEXIO_CLOUD_OFFLINE_BUFFER_FULL_CB=y
 */
#if defined(CONFIG_CONEXIO_CLOUD_OFFLINE_BUFFER_FULL_CB)
static void on_buffer_full(void)
{
    LOG_WRN("Offline buffer full — oldest entry dropped. "
            "Consider increasing CONFIG_CONEXIO_CLOUD_OFFLINE_BUFFER_SIZE.");
}
#endif

/* ── Cloud event handler ────────────────────────────────────────────────── */
static void on_cloud_event(const struct conexio_cloud_event *evt)
{
    switch (evt->type) {
    case CONEXIO_CLOUD_EVT_CONNECTED:
        LOG_INF("Connected — %s | App v%s",
                conexio_cloud_device_id(), APP_VERSION_STRING);
        /* Buffer count after reconnect is logged by the SDK internally */
        break;
    case CONEXIO_CLOUD_EVT_DISCONNECTED:
        LOG_WRN("Disconnected — telemetry will buffer to flash");
        break;
    case CONEXIO_CLOUD_EVT_PUBLISHED:
        LOG_INF("Published (buffer: %d pending)",
                offline_buffer_count());
        break;
    case CONEXIO_CLOUD_EVT_ERROR:
        LOG_ERR("Cloud error: %d", evt->data.error);
        break;
    default:
        break;
    }
}

/* ── main ─────────────────────────────────────────────────────────────── */
int main(void)
{
    LOG_INF("=== Conexio Offline Buffer Sample ===");
    LOG_INF("Buffer: %d entries | Replay batch: %d | TTL: %ds",
            CONFIG_CONEXIO_CLOUD_OFFLINE_BUFFER_SIZE,
            CONFIG_CONEXIO_CLOUD_OFFLINE_REPLAY_BATCH,
            CONFIG_CONEXIO_CLOUD_OFFLINE_BUFFER_TTL_SEC);

    conexio_cloud_register_sensor("temperature", read_temperature, NULL);

#if defined(CONFIG_CONEXIO_CLOUD_OFFLINE_BUFFER_FULL_CB)
    conexio_cloud_register_offline_buffer_full_cb(on_buffer_full);
#endif

    int ret = conexio_cloud_init(on_cloud_event);
    if (ret) { LOG_ERR("init failed (%d)", ret); return -1; }

    LOG_INF("Connecting...");
    if (conexio_cloud_wait_connected(60000) == 0) {
        k_sleep(K_SECONDS(2));
        conexio_cloud_publish();
    }

    while (1) {
        k_sleep(K_SECONDS(5));
    }
    return 0;
}
```
